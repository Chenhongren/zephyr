## drivers/crypto/Kconfig.it51xxx
```kconfig
# Copyright (c) 2025 ITE Corporation.
# SPDX-License-Identifier: Apache-2.0

config CRYPTO_IT51XXX_SHA
	bool "ITE IT51XXX SHA driver"
	default y
	depends on DT_HAS_ITE_IT51XXX_SHA_ENABLED
	select MFD
	select SOC_IT51XXX_HW_CRYPTO_ACCELERATE
	help
	  The IT51XXX hardware supports SHA-256 calculation, which is faster than
	  the firmware implementation.

config CRYPTO_IT51XXX_RSA
	bool "ITE IT51XXX RSA driver"
	depends on DT_HAS_ITE_IT51XXX_RSA_ENABLED
	select MFD
	select SOC_IT51XXX_HW_CRYPTO_ACCELERATE
	select SOC_IT51XXX_CPU_IDLE_GATING
	default y
	help
	  This option enables it51xxx hardware rsa engine.
```

## drivers/misc/it51xxx_hw_rsa/Kconfig
```kconfig
# Copyright (c) 2026 ITE Corporation.
# SPDX-License-Identifier: Apache-2.0

config IT51XXX_HW_RSA_CALCULATION
	bool "IT51XXX hardware RSA calculation"
	default y
	select PM
	select SOC_IT51XXX_CPU_IDLE_GATING
	depends on DT_HAS_ITE_IT51XXX_HW_RSA_ENABLED
	help
	  This option enables it51xxx hardware RSA calculation.

if IT51XXX_HW_RSA_CALCULATION

config IT51XXX_HW_RSA_CALCULATION_TIMEOUT_MS
	int "Set the hardware RSA calculation timeout in milliseconds"
	default 10000
	help
	  This option sets RSA calculation timeout in milliseconds.

endif #IT51XXX_HW_RSA_CALCULATION
```

## drivers/misc/it51xxx_psa_crypto/Kconfig
```kconfig
# Copyright (c) 2026 ITE Corporation.
# SPDX-License-Identifier: Apache-2.0

module = IT51XXX_PSA_CRYPTO
module-str = it51xxx-psa-crypto
source "subsys/logging/Kconfig.template.log_config"

config IT51XXX_PSA_CRYPTO
	bool "ITE IT51XXX PSA crypto device driver"
	depends on DT_HAS_ITE_IT51XXX_CRYPTO_ENABLED
	depends on PSA_CRYPTO
	select SOC_IT51XXX_HW_CRYPTO_ACCELERATE
	default y
	help
	  This option enables the it51xxx psa crypto driver.

if IT51XXX_PSA_CRYPTO

config IT51XXX_PSA_CRYPTO_INIT_PRIORITY
	int "ITE IT51XXX PSA crypto init priority"
	default 40
	help
	  Initialization priority for the it51xxx psa crypto driver.
	  This must be lower than the init priority of the child
	  driver (IT51XXX_PSA_CRYPTO_RSA_INIT_PRIORITY and
	  IT51XXX_PSA_CRYPTO_SHA_INIT_PRIORITY) so the shared
	  resources are ready before child uses them.

config IT51XXX_PSA_CRYPTO_RSA
	bool "IT51XXX PSA crypto RSA driver"
	default y
	depends on DT_HAS_ITE_IT51XXX_PSA_RSA_ENABLED
	select SOC_IT51XXX_CPU_IDLE_GATING
	help
	  This option enables it51xxx psa crypto rsa driver.

if IT51XXX_PSA_CRYPTO_RSA

config IT51XXX_PSA_CRYPTO_RSA_INIT_PRIORITY
	int "IT51XXX PSA crypto RSA init priority"
	default 51
	help
	  The it51xxx psa crypto rsa init priority.

endif # IT51XXX_PSA_CRYPTO_RSA

config IT51XXX_PSA_CRYPTO_SHA
	bool "IT51XXX PSA crypto SHA driver"
	default y
	depends on DT_HAS_ITE_IT51XXX_PSA_SHA_ENABLED
	select SOC_IT51XXX_CPU_IDLE_GATING
	help
	  This option enables it51xxx psa crypto sha driver.

if IT51XXX_PSA_CRYPTO_SHA

config IT51XXX_PSA_CRYPTO_SHA_INIT_PRIORITY
	int "IT51XXX PSA crypto SHA init priority"
	default 51
	help
	  The it51xxx psa crypto sha init priority.

endif # IT51XXX_PSA_CRYPTO_SHA

endif # IT51XXX_PSA_CRYPTO
```

## drivers/misc/ite_i2c/Kconfig
```kconfig
# Copyright (c) 2025 ITE Corporation.
# SPDX-License-Identifier: Apache-2.0

config ITE_I2C_SAMPLE
	bool "ITE I2C Sample"
	default y
	help
	  Enable the ite i2c sample driver, including controller and target devices.

#if ITE_I2C_SAMPLE

config ITE_I2C_CONTROLLER
	bool "ITE I2C controller driver"
	depends on DT_HAS_ITE_I2C_CONTROLLER_ENABLED
	default y

config ITE_I2C_TARGET
	bool "ITE I2C target driver"
	depends on DT_HAS_ITE_I2C_TARGET_ENABLED
	default y

#endif # ITE_I2C_SAMPLE
```

## drivers/mspi/Kconfig.it8xxx2
```kconfig
# Copyright (c) 2026 ITE Corporation.
# SPDX-License-Identifier: Apache-2.0

config MSPI_IT8XXX2
	bool "ITE IT8XXX2 (M)SPI Driver"
	default y
	depends on DT_HAS_ITE_IT8XXX2_MSPI_ENABLED
	select SOC_IT8XXX2_CPU_IDLE_GATING
	help
	  Enable support for the ITE IT8XXX2 (M)SPI driver.

if MSPI_IT8XXX2

endif # MSPI_IT8XXX2
```

## drivers/usb/udc/Kconfig.it51xxx
```kconfig
# Copyright (c) 2026 ITE Corporation.
# SPDX-License-Identifier: Apache-2.0

config UDC_IT51XXX
	bool "IT51XXX USB device controller driver"
	default y
	depends on DT_HAS_ITE_IT51XXX_USB_ENABLED
	select IT51XXX_USB_SOF_CALIBRATION
	help
	  IT51XXX USB device controller driver.

if UDC_IT51XXX

config UDC_IT51XXX_EVENT_COUNT
	int "UDC IT51XXX event count"
	range 4 64
	default 8
	help
	  IT51XXX event count.

config UDC_IT51XXX_STACK_SIZE
	int "IT51XXX UDC driver internal thread stack size"
	default 1024
	help
	  Size of the stack used in the driver for IT51XXX USBD ISR event
	  handling.

endif # UDC_IT51XXX
```

## drivers/usb/uhc/Kconfig.it51xxx
```kconfig
# Copyright (c) 2026 ITE Corporation.
# SPDX-License-Identifier: Apache-2.0

config UHC_IT51XXX
	bool "IT51XXX USB host controller driver"
	default y
	depends on DT_HAS_ITE_IT51XXX_UHC_ENABLED
	help
	  IT51XXX USB host controller driver.

if UHC_IT51XXX

config UHC_IT51XXX_STACK_SIZE
	int "IT51XXX UHC driver internal thread stack size"
	default 1024
	help
	  TODO.

endif # UHC_IT51XXX
```

## dts/bindings/crypto/ite,it51xxx-crypto.yaml
```yaml
# Copyright (c) 2026 ITE Corporation. All Rights Reserved.
# SPDX-License-Identifier: Apache-2.0

description: ITE IT51XXX hardware crypto device driver (PSA).

compatible: "ite,it51xxx-crypto"

include: [base.yaml]

properties:
  reg:
    required: true

  interrupts:
    required: true
```

## dts/bindings/crypto/ite,it51xxx_psa_rsa.yaml
```yaml
# Copyright (c) 2026 ITE Corporation. All Rights Reserved.
# SPDX-License-Identifier: Apache-2.0

description: ITE IT51XXX PSA Crypto RSA accelerator

compatible: "ite,it51xxx-psa-rsa"

include: [base.yaml]
```

## dts/bindings/crypto/ite,it51xxx_psa_sha.yaml
```yaml
# Copyright (c) 2026 ITE Corporation
# SPDX-License-Identifier: Apache-2.0

description: ITE IT51XXX PSA Crypto SHA accelerator.

compatible: "ite,it51xxx-psa-sha"

include: [base.yaml]
```

## dts/bindings/misc/ite,i2c-controller.yaml
```yaml
# Copyright (c) 2025 ITE Corporation. All Rights Reserved.
# SPDX-License-Identifier: Apache-2.0

description: ITE I2C controller driver

compatible: "ite,i2c-controller"

include:
  - name: i2c-device.yaml
    property-blocklist:
      - label

properties:
  label:
    type: string
```

## dts/bindings/misc/ite,i2c-target.yaml
```yaml
# Copyright (c) 2025 ITE Corporation. All Rights Reserved.
# SPDX-License-Identifier: Apache-2.0

description: ITE I2C target driver

compatible: "ite,i2c-target"

include:
  - name: i2c-device.yaml
    property-blocklist:
      - label

properties:
  label:
    type: string
```

## dts/bindings/misc/ite,it51xxx_hw_rsa.yaml
```yaml
# Copyright (c) 2026 ITE Corporation. All Rights Reserved.
# SPDX-License-Identifier: Apache-2.0

description: IT51XXX Hardware RSA controller

compatible: "ite,it51xxx-hw-rsa"

include: [base.yaml]

properties:
  reg:
    required: true

  interrupts:
    required: true
```

## dts/bindings/mspi/ite,it8xxx2-mspi.yaml
```yaml
# Copyright (c) 2024 ITE Corporation. All Rights Reserved.
# SPDX-License-Identifier: Apache-2.0

description: IT8XXX2 MSPI

compatible: "ite,it8xxx2-mspi"

include: [mspi-controller.yaml, pinctrl-device.yaml]

properties:
  reg:
    required: true

  interrupts:
    required: true

  pinctrl-0:
    required: true

  pinctrl-names:
    required: true

  op-mode:
    default: "MSPI_OP_MODE_CONTROLLER"

  duplex:
    default: "MSPI_HALF_DUPLEX"
```

## dts/bindings/usb/ite,it51xxx-uhc.yaml
```yaml
# Copyright (c) 2026 ITE Corporation. All Rights Reserved.
# SPDX-License-Identifier: Apache-2.0

description: ITE IT51XXX usb host controller

compatible: "ite,it51xxx-uhc"

include: [usb-controller.yaml, pinctrl-device.yaml]

properties:
  phy-handle:
    type: phandle

  reg:
    required: true

  interrupts:
    required: true

  pinctrl-0:
    required: true

  pinctrl-names:
    required: true

  extend-ctrl:
    type: array
    description: |
      Extend control configuration for UHC pin mapping on some
      it51xxx SoCs. It is defined as: <reg_address enable_bit disable_bit>
```

## dts/bindings/usb/ite,it51xxx-usb.yaml
```yaml
# Copyright (c) 2026 ITE Corporation. All Rights Reserved.
# SPDX-License-Identifier: Apache-2.0

description: IT51XXX USB

compatible: "ite,it51xxx-usb"

include: [pinctrl-device.yaml, usb-ep.yaml]

properties:
  reg:
    required: true

  interrupts-extended:
    required: true

  pinctrl-0:
    required: true

  pinctrl-names:
    required: true

  wucctrl:
    type: phandles
    description: |
      usbd node WUC interrupt.
```

## modules/Kconfig.ite
```kconfig
# Copyright (c) 2026 ITE Corporation. All Rights Reserved.
# SPDX-License-Identifier: Apache-2.0

config ZEPHYR_HAL_ITE_MODULE
	bool

config ZEPHYR_HAL_ITE_MODULE_BLOBS
	bool
```

## modules/hal_ite/Kconfig
```kconfig
# Copyright (c) 2026 ITE Corporation.
# SPDX-License-Identifier: Apache-2.0

rsource "Kconfig.psa_crypto_driver"
```

## modules/hal_ite/Kconfig.psa_crypto_driver
```kconfig
# Copyright (c) 2026 ITE Corporation.
# SPDX-License-Identifier: Apache-2.0

module = PSA_CRYPTO_IT51XXX
module-str = psa-crypto-it51xxx
source "subsys/logging/Kconfig.template.log_config"

config PSA_CRYPTO_DRIVER_ITE_IT51XXX
	bool "Build psa_crypto_driver for it51xxx"
	depends on MBEDTLS_PSA_CRYPTO_C
	select SOC_IT51XXX_HW_CRYPTO_ACCELERATE
	default y if DT_HAS_ITE_IT51XXX_CRYPTO_ENABLED
	help
	  This option enables hardware-accelerated PSA crypto operations
	  on it51xxx SoCs. Operations not supported by the hardware
	  driver fall back to software.

if PSA_CRYPTO_DRIVER_ITE_IT51XXX

config PSA_CRYPTO_DRIVER_ITE_IT51XXX_RSA
	bool "Enable it51xxx rsa driver"
	select SOC_IT51XXX_CPU_IDLE_GATING
	default y if DT_HAS_ITE_IT51XXX_PSA_RSA_ENABLED
	help
	  This option enables the it51xxx hardware RSA driver for
	  PSA crypto. The driver supports RSA PKCS#1 v1.5 signature
	  generation and verification.

config PSA_CRYPTO_DRIVER_ITE_IT51XXX_SHA
	bool "Enable it51xxx sha driver"
	select SOC_IT51XXX_CPU_IDLE_GATING
	default y if DT_HAS_ITE_IT51XXX_PSA_SHA_ENABLED
	help
	  This option enables the it51xxx hardware SHA driver for
	  PSA crypto.

configdefault TF_PSA_CRYPTO_DRIVER_CONFIG_FILE
	default "ite-crypto-config.h"

configdefault TF_PSA_CRYPTO_DISPATCH_DIR
	default "$(ZEPHYR_HAL_ITE_MODULE_DIR)/psa_crypto_drivers/dispatch"

configdefault SHARED_INTERRUPTS
	default y if $(dt_nodelabel_enabled,sha) && $(dt_nodelabel_enabled,rsa)

configdefault SHARED_IRQ_MAX_NUM_CLIENTS
	default 2 if $(dt_nodelabel_enabled,sha) && $(dt_nodelabel_enabled,rsa)

endif # PSA_CRYPTO_DRIVER_ITE_IT51XXX
```

## samples/drivers/espi/boards/it51xxx_evb_it5510bw.conf
```kconfig
CONFIG_ESPI=y
CONFIG_ESPI_LOG_LEVEL_INF=y
CONFIG_ESPI_PERIPHERAL_HOST_CMD_PARAM_PORT_NUM=0xa00
CONFIG_ESPI_PERIPHERAL_HOST_IO=y
CONFIG_ESPI_PERIPHERAL_EC_HOST_CMD=y

CONFIG_ESPI_PERIPHERAL_CUSTOM_OPCODE=n # ACPI test/port-200 test

CONFIG_LOG=y
CONFIG_SHELL=y
```

## soc/ite/ec/it51xxx/Kconfig.defconfig.it5510bw
```kconfig
# Copyright (c) 2026 ITE Corporation.
# SPDX-License-Identifier: Apache-2.0

if SOC_IT5510BW

config ITE_IT51XXX_INTC_VECTOR_LOADING_CTRL_SUPPORTED
	default y

endif # SOC_IT5510BW
```

## soc/ite/ec/it51xxx/Kconfig.defconfig.it58000aw
```kconfig
# Copyright (c) 2026 ITE Corporation.
# SPDX-License-Identifier: Apache-2.0

if SOC_IT58000AW

config ITE_IT51XXX_INTC_VECTOR_LOADING_CTRL_SUPPORTED
	default y

config SOC_IT51XXX_USB_GPIO_CONTROL
	default y

endif # SOC_IT58000AW
```

## tests/subsys/pmci/mctp/i3c/boards/it51xxx_evb_it51526aw.conf
```kconfig
CONFIG_I3CS_TX_FIFO_4096_BYTE=y
CONFIG_I3CS_RX_FIFO_4096_BYTE=y

CONFIG_I3C_INIT_RSTACT=n
CONFIG_I3CM_IT51XXX_DLM_SIZE=512
```

## tests/subsys/pmci/mctp/i3c/testcase.yaml
```yaml
tests:
  pmci.mctp.i3c.ping_pong:
    platform_allow:
      - npcx4m8f_evb
    tags:
      - mctp
      - i3c
    harness_config:
      fixture: i3c_loopback
  pmci.mctp.i3c.ping_pong.it51xxx:
    platform_allow:
      - it51xxx_evb/it51526aw
      - it51xxx_evb/it58000aw
    extra_configs:
      - CONFIG_I3CS_TX_FIFO_4096_BYTE=y
      - CONFIG_I3CS_RX_FIFO_4096_BYTE=y
      - CONFIG_I3C_INIT_RSTACT=n
      - CONFIG_I3CM_IT51XXX_DLM_SIZE=512
    extra_args:
      - DTC_OVERLAY_FILE="boards/it51xxx_evb_common.overlay"
    tags:
      - mctp
      - i3c
    harness_config:
      fixture: i3c_loopback
```
