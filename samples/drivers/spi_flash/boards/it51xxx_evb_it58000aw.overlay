/*
 * Copyright (c) 2026 ITE Corporation. All Rights Reserved.
 *
 * SPDX-License-Identifier: Apache-2.0
 */

&spi0 {
	status = "okay";

	pinctrl-0 = <&ssce0_gpj7_default &ssce1_gph7_default
		     &ssck_gpa6_default &smosi_gpc6_default
		     &smiso_gpc4_default>;
	pinctrl-names = "default";

	mx25r16: mx25v1635f@0 {
		compatible = "jedec,spi-nor";
		reg = <0>;
		spi-max-frequency = <12000000>;
		jedec-id = [c2 23 15];
		size = <0x1000000>;
		status = "okay";
	};

};
