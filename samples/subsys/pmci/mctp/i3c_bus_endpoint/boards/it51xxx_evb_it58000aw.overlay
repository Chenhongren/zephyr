/*
 * Copyright (c) 2026 ITE Corporation. All Rights Reserved.
 *
 * SPDX-License-Identifier: Apache-2.0
 */

/ {
	mctp_i3c: mctp_i3c {
		compatible = "zephyr,mctp-i3c-target";
		i3c = <&i3c3>;
		endpoint-id = <11>;
	};
};

&i3c2 {
	status = "disabled";

	pinctrl-0 = < &i3c2_clk_gpe2_default &i3c2_data_gpe3_default>;
	pinctrl-names = "default";

	disable-read-abort;
	static-address = <0x18>;
	bcr = <0x06>;
	pid-random-value = <0x00000011>;
};

&i3c3 {
	status = "okay";

	pinctrl-0 = < &i3c3_clk_gpf0_default &i3c3_data_gpf1_default>;
	pinctrl-names = "default";

	disable-read-abort;
	static-address = <0x18>;
	bcr = <0x06>;
	pid-random-value = <0x00000011>;
};
