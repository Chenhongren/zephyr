## CMakeLists.txt
```
# Copyright (c) 2024 Nordic Semiconductor ASA
# SPDX-License-Identifier: Apache-2.0


cmake_minimum_required(VERSION 3.28.0)
find_package(Zephyr REQUIRED HINTS $ENV{ZEPHYR_BASE})
project(mbedtls)

zephyr_include_directories(include)

target_sources(app PRIVATE src/main.c)
```

## prj.conf
```kconfig
CONFIG_ZTEST_STACK_SIZE=4096
CONFIG_ZTEST=y

# That's needed because when we call "psa_crypto_init()" in TF-PSA-Crypto
# on initialization the stack being used is the "main" one.
CONFIG_MAIN_STACK_SIZE=2048

CONFIG_PSA_CRYPTO=y
CONFIG_MBEDTLS_PSA_STATIC_KEY_SLOTS=n

CONFIG_PSA_WANT_ALG_SHA_1=y
CONFIG_PSA_WANT_ALG_SHA_224=y
CONFIG_PSA_WANT_ALG_SHA_256=y
CONFIG_PSA_WANT_ALG_SHA_384=y
CONFIG_PSA_WANT_ALG_SHA_512=y

CONFIG_PSA_WANT_ALG_HMAC=y
CONFIG_PSA_WANT_KEY_TYPE_HMAC=y

CONFIG_PSA_WANT_KEY_TYPE_AES=y
CONFIG_PSA_WANT_ALG_ECB_NO_PADDING=y

CONFIG_PSA_WANT_ALG_RSA_PKCS1V15_CRYPT=y
CONFIG_PSA_WANT_ALG_RSA_PKCS1V15_SIGN=y
CONFIG_PSA_WANT_KEY_TYPE_RSA_PUBLIC_KEY=y

CONFIG_IT51XXX_PSA_CRYPTO_LOG_LEVEL_DBG=y
```

## boards/it51xxx_evb_it51526aw.overlay
```dts
/*
 * Copyright (c) 2026 ITE Corporation. All Rights Reserved.
 *
 * SPDX-License-Identifier: Apache-2.0
 */

&sha256 {
	status = "disabled";
};

&psa_crypto {
	status = "okay";
};

&psa_sha {
	status = "okay";
};

&psa_rsa {
	status = "okay";
};
```

## include/rsa_2048.h
```c
/*
 * Copyright (c) 2026 ITE Technology Inc.
 *
 * SPDX-License-Identifier: Apache-2.0
 */

#ifndef ZEPHYR_TESTS_CRYPTO_PSA_RSA_2048_H
#define ZEPHYR_TESTS_CRYPTO_PSA_RSA_2048_H

#define RSA_BITS_2048 2048

static const uint8_t private_key_der[] = {
	0x30, 0x82, 0x04, 0xA4, 0x02, 0x01, 0x00, 0x02, 0x82, 0x01, 0x01, 0x00, 0xC2, 0x1E, 0x0F,
	0x50, 0xF2, 0xC5, 0xCB, 0xA3, 0x36, 0x10, 0x5E, 0xB2, 0x9A, 0xB0, 0x4B, 0xA2, 0x00, 0xC2,
	0xE2, 0x11, 0xA2, 0x19, 0xBF, 0xB6, 0x23, 0xA1, 0xF5, 0x36, 0xA4, 0x8F, 0x6F, 0xC3, 0x36,
	0xC7, 0x39, 0x8B, 0x03, 0xA1, 0xB8, 0x1B, 0xDD, 0xC9, 0xAD, 0xFD, 0xD6, 0xC8, 0x69, 0x14,
	0x28, 0xC1, 0x67, 0x81, 0xC9, 0x20, 0x21, 0xB9, 0x35, 0x19, 0x95, 0xA5, 0x47, 0x2B, 0x01,
	0x42, 0x02, 0x83, 0x6A, 0x61, 0x81, 0xC2, 0xC9, 0xAC, 0xB2, 0xF2, 0xE0, 0xF3, 0xF9, 0x7A,
	0xB5, 0xA9, 0x60, 0x00, 0x2B, 0x17, 0xF9, 0x55, 0x90, 0x11, 0x29, 0x28, 0xA1, 0xE4, 0xA1,
	0xC3, 0xB1, 0x53, 0xF9, 0x78, 0x7C, 0x3B, 0x74, 0x7B, 0x27, 0xAA, 0x8D, 0xFA, 0xD9, 0xF2,
	0x98, 0x85, 0xAB, 0x2B, 0x55, 0x32, 0x4A, 0x6E, 0x0C, 0xF1, 0xED, 0xBB, 0x0F, 0x6C, 0x1F,
	0x86, 0x1D, 0x10, 0xFC, 0xF2, 0x4D, 0xFC, 0x01, 0x7D, 0xB8, 0x77, 0xC6, 0xA1, 0x5B, 0x18,
	0x68, 0x1C, 0x07, 0xA7, 0x9F, 0x82, 0xC0, 0x35, 0x3A, 0x61, 0xF3, 0x34, 0x62, 0x2F, 0x47,
	0x73, 0x0E, 0xD7, 0xDD, 0x9D, 0xE5, 0x5C, 0x97, 0x8D, 0x78, 0x5E, 0xD7, 0xAA, 0x8F, 0x48,
	0xB8, 0x09, 0x33, 0x83, 0x88, 0x57, 0xFE, 0x17, 0x3A, 0xDC, 0x1C, 0x75, 0x92, 0xC0, 0xC1,
	0xB2, 0x78, 0x85, 0x54, 0xF7, 0xD7, 0xA3, 0xCD, 0xA8, 0x12, 0x35, 0x38, 0x16, 0x00, 0x58,
	0xEE, 0xD6, 0x54, 0x59, 0x19, 0x5D, 0x9E, 0x55, 0x26, 0x74, 0x29, 0x1D, 0xF5, 0x8C, 0x72,
	0xD4, 0x1F, 0xC5, 0x09, 0x00, 0x29, 0x04, 0x29, 0x71, 0x69, 0xC6, 0x59, 0x3A, 0x54, 0x4B,
	0x2F, 0xA0, 0xBD, 0x18, 0x47, 0xB1, 0x02, 0x70, 0x5A, 0xB8, 0x45, 0xBE, 0x28, 0xE0, 0xA5,
	0x08, 0xCB, 0x40, 0x93, 0x65, 0x7A, 0xC4, 0xA6, 0x8F, 0xC3, 0x53, 0xFC, 0xC1, 0x02, 0x03,
	0x01, 0x00, 0x01, 0x02, 0x82, 0x01, 0x00, 0x13, 0x51, 0x8F, 0x08, 0x29, 0x15, 0x16, 0xC2,
	0x58, 0x35, 0xD2, 0x5A, 0xD7, 0x8A, 0xBE, 0x88, 0x31, 0xA7, 0xB3, 0x7C, 0x7A, 0x43, 0xB2,
	0x40, 0xE3, 0xF4, 0x71, 0x15, 0x3E, 0x54, 0xD9, 0x14, 0x56, 0x3E, 0x07, 0x03, 0xC6, 0xF9,
	0x7F, 0xFB, 0x63, 0xFB, 0xF7, 0x91, 0x28, 0xE0, 0x3A, 0x96, 0xEB, 0x44, 0x6E, 0x32, 0xEC,
	0x2B, 0x82, 0xB7, 0xAE, 0x29, 0x6C, 0xEB, 0x6D, 0x35, 0x02, 0x33, 0xC9, 0xD0, 0xBE, 0xD4,
	0x53, 0xE7, 0xE9, 0x0E, 0xC3, 0x23, 0x69, 0x50, 0x56, 0x8E, 0x88, 0x08, 0x42, 0x79, 0xD9,
	0xD0, 0x11, 0xBC, 0x1A, 0x71, 0x9E, 0xC5, 0x40, 0xB1, 0x62, 0x88, 0xF9, 0x7B, 0xA8, 0x3A,
	0xFD, 0xB0, 0x24, 0x14, 0x42, 0x9B, 0x16, 0x74, 0xB5, 0xDE, 0x8F, 0x1F, 0xD4, 0x6C, 0x64,
	0x56, 0xF4, 0x31, 0xD6, 0x1F, 0x78, 0x9F, 0x92, 0x76, 0x1A, 0x00, 0x0C, 0xA1, 0xFD, 0x6E,
	0x4A, 0x7F, 0xA7, 0x27, 0x4E, 0x5F, 0x3A, 0x6B, 0x6A, 0x6E, 0x4D, 0xD9, 0x2C, 0xEF, 0x2F,
	0x17, 0xF4, 0xF8, 0x5F, 0x04, 0xB6, 0xED, 0xEA, 0x18, 0x64, 0x55, 0x91, 0x17, 0x3A, 0xD1,
	0xE7, 0x07, 0xCD, 0x9C, 0x3B, 0x53, 0xEE, 0xA2, 0x55, 0x74, 0x5F, 0x4B, 0xA2, 0x9E, 0xF1,
	0x38, 0x92, 0x3F, 0x10, 0x18, 0x76, 0x97, 0xE3, 0xEA, 0xF0, 0xB4, 0x15, 0xD1, 0xE8, 0x96,
	0x31, 0x33, 0x75, 0x81, 0x8A, 0xD5, 0xE9, 0xC0, 0x5F, 0x88, 0x60, 0x18, 0x6D, 0xEC, 0xE9,
	0x87, 0xD0, 0xFC, 0xED, 0x12, 0xE0, 0x29, 0xDA, 0x9D, 0xA7, 0xB9, 0x9B, 0x15, 0xD7, 0x04,
	0xD5, 0xCD, 0xFE, 0x0E, 0x38, 0xA1, 0x06, 0xF8, 0xA6, 0x86, 0xEB, 0x63, 0x99, 0x7D, 0x5E,
	0x42, 0x3C, 0x5B, 0x2C, 0xDC, 0x5D, 0x38, 0x7F, 0xAF, 0xE5, 0x15, 0x3A, 0x89, 0x0F, 0xCF,
	0x40, 0x26, 0xD5, 0x84, 0xA5, 0xE4, 0x33, 0xF1, 0x02, 0x81, 0x81, 0x00, 0xE6, 0x8A, 0xA7,
	0x6F, 0xDB, 0x34, 0xDB, 0x51, 0x93, 0xFB, 0xF9, 0x57, 0xA3, 0xE5, 0x50, 0x35, 0xA0, 0xA5,
	0x6E, 0xE4, 0xA4, 0xA1, 0xF6, 0xEB, 0xEC, 0x1D, 0x6B, 0x6E, 0xCC, 0x29, 0x46, 0x9C, 0x7E,
	0xAA, 0x07, 0x80, 0x0E, 0xAF, 0x06, 0x8B, 0x0B, 0x22, 0xC1, 0x54, 0x97, 0xC7, 0x6B, 0x8C,
	0xB0, 0xBF, 0x02, 0x15, 0x03, 0x13, 0xA1, 0x36, 0x61, 0x78, 0xE9, 0x37, 0x51, 0x06, 0x63,
	0x0F, 0xF6, 0x5B, 0x9E, 0x4A, 0x2D, 0x27, 0x53, 0xE3, 0x53, 0x55, 0x37, 0x8F, 0x71, 0xB9,
	0xDC, 0xFF, 0x46, 0xB0, 0xAF, 0x20, 0xBD, 0x67, 0x71, 0x78, 0xCC, 0xB1, 0x26, 0x1E, 0x98,
	0x4D, 0x91, 0x51, 0x68, 0x6F, 0x84, 0x51, 0xCC, 0xD1, 0xE6, 0xA3, 0x65, 0x83, 0xC1, 0x09,
	0x16, 0x5F, 0x0A, 0x3F, 0x4E, 0x43, 0x50, 0x3C, 0x0D, 0x35, 0xD8, 0x57, 0x24, 0x41, 0x13,
	0xDA, 0xA1, 0x91, 0xD9, 0x59, 0x02, 0x81, 0x81, 0x00, 0xD7, 0x8D, 0xB4, 0x40, 0xBB, 0x4C,
	0x7C, 0x1C, 0x28, 0xE4, 0xFB, 0x11, 0x68, 0x3F, 0xB6, 0x97, 0xB4, 0xC2, 0x38, 0xDB, 0x61,
	0xCC, 0xAC, 0xDB, 0x9F, 0x00, 0xEB, 0x69, 0xC7, 0x37, 0xE2, 0xDE, 0xF6, 0x47, 0x35, 0x2A,
	0x07, 0x81, 0xF1, 0x73, 0xD8, 0x7C, 0xBF, 0x94, 0xF2, 0x90, 0xE3, 0x41, 0x0A, 0x2F, 0xAE,
	0x3D, 0x19, 0x23, 0x28, 0x50, 0x6C, 0x56, 0xEE, 0x6E, 0x8C, 0xD9, 0x8A, 0x26, 0xBD, 0x9A,
	0x21, 0x32, 0xC6, 0xED, 0x99, 0x63, 0x0B, 0x02, 0xB4, 0xCE, 0x48, 0x0D, 0x79, 0x2C, 0x4D,
	0x2B, 0x32, 0x34, 0xDC, 0xD9, 0xDA, 0x63, 0x45, 0x79, 0xFC, 0xCA, 0x50, 0x29, 0xA3, 0x34,
	0x3E, 0x0F, 0x28, 0x2F, 0xB6, 0x2C, 0xBD, 0x29, 0x3A, 0x8B, 0x6E, 0x95, 0x7C, 0x47, 0x54,
	0xC2, 0x29, 0x76, 0x73, 0xFD, 0x33, 0xB3, 0xEA, 0x4A, 0x8F, 0x26, 0x15, 0x04, 0xE4, 0x56,
	0x69, 0xA9, 0x02, 0x81, 0x80, 0x5F, 0x4D, 0x6A, 0x32, 0x1F, 0x58, 0x16, 0x61, 0xFE, 0xDE,
	0xE7, 0x10, 0x87, 0xBC, 0x40, 0x10, 0x2B, 0x3C, 0xB8, 0x3E, 0xE4, 0x9F, 0xDF, 0xC7, 0x5F,
	0x70, 0x39, 0xFD, 0x2F, 0x80, 0xD0, 0xA3, 0xD8, 0xE8, 0xC8, 0xF8, 0xF3, 0x18, 0xFF, 0x87,
	0x73, 0x2F, 0x06, 0xE4, 0xC5, 0x69, 0xB6, 0xD8, 0x0E, 0x28, 0xA7, 0xDF, 0xAF, 0xC9, 0xE9,
	0x96, 0xE5, 0x6C, 0x6A, 0x5C, 0x67, 0xAE, 0x50, 0x3D, 0x45, 0x06, 0x52, 0xC5, 0x2F, 0x2D,
	0x56, 0xCC, 0x5E, 0xA2, 0x97, 0xB9, 0x40, 0xB6, 0x28, 0xD9, 0x8E, 0x8B, 0x73, 0x9A, 0x01,
	0x32, 0x46, 0x02, 0x3D, 0xFB, 0xED, 0x5A, 0x30, 0x73, 0xC0, 0x62, 0xFA, 0xDD, 0x3E, 0xC1,
	0xE1, 0xFD, 0xD3, 0x6E, 0x30, 0x84, 0xEA, 0xC3, 0xAA, 0xEF, 0xD6, 0xF8, 0x9C, 0x8D, 0xCF,
	0x19, 0x44, 0x0C, 0xC2, 0x46, 0x23, 0xC2, 0x93, 0x46, 0x8A, 0x0C, 0x14, 0xE1, 0x02, 0x81,
	0x81, 0x00, 0x95, 0x57, 0x8A, 0x51, 0x66, 0xF3, 0x40, 0xF1, 0xC9, 0xAB, 0x8B, 0xFF, 0xAD,
	0x78, 0xA7, 0x2B, 0x48, 0x83, 0x60, 0x1D, 0x2F, 0x0F, 0x3D, 0x9C, 0x13, 0xF7, 0xF1, 0x22,
	0xA2, 0x72, 0x27, 0xEF, 0x4E, 0x36, 0x5B, 0xB1, 0x38, 0xEE, 0x60, 0xB9, 0x60, 0x7E, 0x5D,
	0xC5, 0xF6, 0xA1, 0x47, 0xB2, 0x22, 0x3A, 0x92, 0xBF, 0xA6, 0x10, 0xE3, 0xB7, 0x84, 0xB8,
	0x5E, 0x0D, 0x9D, 0xEC, 0x82, 0x79, 0x00, 0xD8, 0x2E, 0xB4, 0x1D, 0x7B, 0x34, 0xD0, 0x98,
	0x2A, 0x51, 0xD6, 0xB1, 0xB9, 0x14, 0x01, 0x0B, 0x9E, 0x27, 0xF4, 0xD4, 0x26, 0xE3, 0xD5,
	0xEF, 0xA6, 0xEA, 0xEB, 0xC8, 0xCA, 0x70, 0x56, 0x9B, 0xC0, 0xA8, 0x99, 0x15, 0xE0, 0xBD,
	0x56, 0x39, 0x47, 0xAD, 0x60, 0x48, 0x70, 0xAB, 0x5A, 0xB2, 0x9B, 0x6D, 0x15, 0x3A, 0xA3,
	0x26, 0x6A, 0x6D, 0xEF, 0x76, 0x94, 0xA3, 0x16, 0xF3, 0xB1, 0x02, 0x81, 0x81, 0x00, 0x87,
	0xEA, 0x17, 0xFC, 0x70, 0x55, 0x55, 0xB9, 0xE1, 0xFB, 0xE5, 0x1C, 0x29, 0x15, 0x24, 0xEF,
	0x40, 0x85, 0x29, 0xA9, 0x99, 0x10, 0x23, 0xE6, 0x5A, 0xE4, 0x4F, 0x69, 0xB9, 0xF2, 0xA3,
	0x20, 0x04, 0x72, 0x61, 0xA5, 0xBD, 0xA9, 0xEB, 0x8D, 0x48, 0x00, 0x7D, 0x08, 0xFB, 0x1B,
	0x44, 0xE6, 0x1B, 0x83, 0x0E, 0xAA, 0x62, 0x6C, 0x68, 0x96, 0xFF, 0xDD, 0x45, 0x8E, 0xC3,
	0x8F, 0xBB, 0x41, 0x39, 0x54, 0xCA, 0xAD, 0xD8, 0x50, 0x27, 0x5B, 0x82, 0x67, 0x55, 0x21,
	0xEB, 0x78, 0xEA, 0x46, 0xC0, 0x49, 0x23, 0x64, 0xBD, 0x90, 0x86, 0x11, 0xAF, 0x3A, 0x88,
	0xB8, 0xD3, 0x4C, 0xD8, 0x46, 0x59, 0xFB, 0x68, 0xA4, 0x9A, 0x28, 0xCE, 0x09, 0xDB, 0x8A,
	0xD6, 0xB5, 0x17, 0x12, 0x4B, 0xBA, 0x3C, 0x9D, 0x23, 0x51, 0x33, 0x34, 0xD3, 0x2D, 0x3E,
	0x57, 0x66, 0xB7, 0xCE, 0xEE, 0x1E, 0xF7,
};

static const uint8_t public_key_der[] = {
	0x30, 0x82, 0x01, 0x0A, 0x02, 0x82, 0x01, 0x01, 0x00, 0xC2, 0x1E, 0x0F, 0x50, 0xF2, 0xC5,
	0xCB, 0xA3, 0x36, 0x10, 0x5E, 0xB2, 0x9A, 0xB0, 0x4B, 0xA2, 0x00, 0xC2, 0xE2, 0x11, 0xA2,
	0x19, 0xBF, 0xB6, 0x23, 0xA1, 0xF5, 0x36, 0xA4, 0x8F, 0x6F, 0xC3, 0x36, 0xC7, 0x39, 0x8B,
	0x03, 0xA1, 0xB8, 0x1B, 0xDD, 0xC9, 0xAD, 0xFD, 0xD6, 0xC8, 0x69, 0x14, 0x28, 0xC1, 0x67,
	0x81, 0xC9, 0x20, 0x21, 0xB9, 0x35, 0x19, 0x95, 0xA5, 0x47, 0x2B, 0x01, 0x42, 0x02, 0x83,
	0x6A, 0x61, 0x81, 0xC2, 0xC9, 0xAC, 0xB2, 0xF2, 0xE0, 0xF3, 0xF9, 0x7A, 0xB5, 0xA9, 0x60,
	0x00, 0x2B, 0x17, 0xF9, 0x55, 0x90, 0x11, 0x29, 0x28, 0xA1, 0xE4, 0xA1, 0xC3, 0xB1, 0x53,
	0xF9, 0x78, 0x7C, 0x3B, 0x74, 0x7B, 0x27, 0xAA, 0x8D, 0xFA, 0xD9, 0xF2, 0x98, 0x85, 0xAB,
	0x2B, 0x55, 0x32, 0x4A, 0x6E, 0x0C, 0xF1, 0xED, 0xBB, 0x0F, 0x6C, 0x1F, 0x86, 0x1D, 0x10,
	0xFC, 0xF2, 0x4D, 0xFC, 0x01, 0x7D, 0xB8, 0x77, 0xC6, 0xA1, 0x5B, 0x18, 0x68, 0x1C, 0x07,
	0xA7, 0x9F, 0x82, 0xC0, 0x35, 0x3A, 0x61, 0xF3, 0x34, 0x62, 0x2F, 0x47, 0x73, 0x0E, 0xD7,
	0xDD, 0x9D, 0xE5, 0x5C, 0x97, 0x8D, 0x78, 0x5E, 0xD7, 0xAA, 0x8F, 0x48, 0xB8, 0x09, 0x33,
	0x83, 0x88, 0x57, 0xFE, 0x17, 0x3A, 0xDC, 0x1C, 0x75, 0x92, 0xC0, 0xC1, 0xB2, 0x78, 0x85,
	0x54, 0xF7, 0xD7, 0xA3, 0xCD, 0xA8, 0x12, 0x35, 0x38, 0x16, 0x00, 0x58, 0xEE, 0xD6, 0x54,
	0x59, 0x19, 0x5D, 0x9E, 0x55, 0x26, 0x74, 0x29, 0x1D, 0xF5, 0x8C, 0x72, 0xD4, 0x1F, 0xC5,
	0x09, 0x00, 0x29, 0x04, 0x29, 0x71, 0x69, 0xC6, 0x59, 0x3A, 0x54, 0x4B, 0x2F, 0xA0, 0xBD,
	0x18, 0x47, 0xB1, 0x02, 0x70, 0x5A, 0xB8, 0x45, 0xBE, 0x28, 0xE0, 0xA5, 0x08, 0xCB, 0x40,
	0x93, 0x65, 0x7A, 0xC4, 0xA6, 0x8F, 0xC3, 0x53, 0xFC, 0xC1, 0x02, 0x03, 0x01, 0x00, 0x01,
};

#endif /* ZEPHYR_TESTS_CRYPTO_PSA_RSA_2048_H */
```
