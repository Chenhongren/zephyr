## CMakeLists.txt
```
# Copyright (c) 2026 ITE Corporation.
# SPDX-License-Identifier: Apache-2.0

cmake_minimum_required(VERSION 3.20.0)
find_package(Zephyr REQUIRED HINTS $ENV{ZEPHYR_BASE})
project(hw_rsa)

FILE(GLOB app_sources src/*.c)
target_sources(app PRIVATE src/test_hw_rsa.c)
```

## prj.conf
```kconfig
# Copyright (c) 2026 ITE Corporation.
# SPDX-License-Identifier: Apache-2.0

CONFIG_TEST=y
CONFIG_ZTEST=y
CONFIG_TEST_USERSPACE=y

CONFIG_LOG=y
CONFIG_SHELL=y
```

## src/rsa_2048_keys.h
```c
/*
 * Copyright (c) 2026 ITE Technology Inc.
 *
 * SPDX-License-Identifier: Apache-2.0
 */

#ifndef ZEPHYR_TESTS_IT51XXX_EVB_RSA_2048_KEYS_H
#define ZEPHYR_TESTS_IT51XXX_EVB_RSA_2048_KEYS_H

#define ITE_DEBUG 0 /* 0: form SA-Kant, 1: from psa rsa key generation */

#if ITE_DEBUG
static const uint8_t public_key_2048[] = {
	0x6B, 0xD0, 0xA2, 0x82, 0x0D, 0x8B, 0x54, 0x67, 0x88, 0x98, 0x7C, 0xBF, 0x51, 0x39, 0xEA,
	0x00, 0x83, 0x34, 0x88, 0xEA, 0x92, 0x36, 0xC8, 0x90, 0x58, 0xB9, 0xB9, 0xA1, 0xA2, 0xF6,
	0x2D, 0xEB, 0xCE, 0xB5, 0xCC, 0x8D, 0x3C, 0xD9, 0xEA, 0xFC, 0x7E, 0x41, 0x81, 0x6E, 0xB5,
	0xE3, 0x13, 0x8D, 0xBD, 0x2C, 0x88, 0x52, 0x80, 0x7B, 0xCE, 0x75, 0x5F, 0x4C, 0xA1, 0x89,
	0xCA, 0xC8, 0xB1, 0xA7, 0x96, 0xAF, 0x8E, 0x48, 0x29, 0xA9, 0x3B, 0xDC, 0xC2, 0x8D, 0x15,
	0xA3, 0x17, 0x04, 0x38, 0xA9, 0x74, 0xB8, 0x8A, 0x90, 0xA9, 0xE7, 0x04, 0x47, 0x60, 0x56,
	0x57, 0x54, 0xAD, 0x8D, 0x6A, 0x5B, 0x59, 0x33, 0x42, 0xB2, 0x28, 0x32, 0x9B, 0x1C, 0x95,
	0x61, 0xE8, 0xAC, 0xEA, 0xD1, 0x63, 0xF7, 0x90, 0x48, 0xEA, 0xAA, 0x64, 0x61, 0xC3, 0x4B,
	0xA5, 0x44, 0x10, 0xE9, 0x36, 0x74, 0x12, 0x55, 0x74, 0xAE, 0xD5, 0x54, 0xFA, 0xDD, 0x5D,
	0x1A, 0x90, 0xD5, 0x0B, 0xD6, 0x23, 0x95, 0xF6, 0xC2, 0x62, 0x48, 0x46, 0x55, 0xED, 0x42,
	0xD0, 0x6E, 0x01, 0x52, 0x75, 0xD2, 0xE4, 0x0B, 0x40, 0xFE, 0x5D, 0x19, 0xAC, 0x28, 0x9C,
	0xCD, 0x57, 0x2B, 0xAC, 0x9E, 0x3F, 0x38, 0x86, 0x7F, 0x4E, 0x20, 0x0F, 0x6C, 0xB1, 0x7B,
	0xC8, 0x85, 0xA4, 0xED, 0x9F, 0x0D, 0x5A, 0xB5, 0x9A, 0x79, 0xAE, 0x25, 0xF2, 0xF0, 0x1E,
	0x12, 0x66, 0x91, 0xBA, 0x52, 0xCD, 0x4B, 0xC8, 0x15, 0x1E, 0xDD, 0xE9, 0xCF, 0x90, 0xCA,
	0xC7, 0xE6, 0x0A, 0x05, 0x17, 0xF9, 0x51, 0x71, 0xED, 0x86, 0xFF, 0x92, 0x1C, 0x10, 0x4C,
	0x3C, 0x03, 0xE9, 0xDC, 0x2C, 0x1F, 0x59, 0x01, 0x92, 0xE3, 0x99, 0xBB, 0x25, 0x1C, 0x34,
	0x27, 0x17, 0xCD, 0xA2, 0x52, 0x82, 0xD1, 0x77, 0x99, 0x98, 0x59, 0x1D, 0x7E, 0x89, 0x53,
	0xE2};
#else
static const uint8_t public_key_2048[256] = {
	0xC2, 0x1E, 0x0F, 0x50, 0xF2, 0xC5, 0xCB, 0xA3, 0x36, 0x10, 0x5E, 0xB2,
	0x9A, 0xB0, 0x4B, 0xA2, 0x00, 0xC2, 0xE2, 0x11, 0xA2, 0x19, 0xBF, 0xB6,
	0x23, 0xA1, 0xF5, 0x36, 0xA4, 0x8F, 0x6F, 0xC3, 0x36, 0xC7, 0x39, 0x8B,
	0x03, 0xA1, 0xB8, 0x1B, 0xDD, 0xC9, 0xAD, 0xFD, 0xD6, 0xC8, 0x69, 0x14,
	0x28, 0xC1, 0x67, 0x81, 0xC9, 0x20, 0x21, 0xB9, 0x35, 0x19, 0x95, 0xA5,
	0x47, 0x2B, 0x01, 0x42, 0x02, 0x83, 0x6A, 0x61, 0x81, 0xC2, 0xC9, 0xAC,
	0xB2, 0xF2, 0xE0, 0xF3, 0xF9, 0x7A, 0xB5, 0xA9, 0x60, 0x00, 0x2B, 0x17,
	0xF9, 0x55, 0x90, 0x11, 0x29, 0x28, 0xA1, 0xE4, 0xA1, 0xC3, 0xB1, 0x53,
	0xF9, 0x78, 0x7C, 0x3B, 0x74, 0x7B, 0x27, 0xAA, 0x8D, 0xFA, 0xD9, 0xF2,
	0x98, 0x85, 0xAB, 0x2B, 0x55, 0x32, 0x4A, 0x6E, 0x0C, 0xF1, 0xED, 0xBB,
	0x0F, 0x6C, 0x1F, 0x86, 0x1D, 0x10, 0xFC, 0xF2, 0x4D, 0xFC, 0x01, 0x7D,
	0xB8, 0x77, 0xC6, 0xA1, 0x5B, 0x18, 0x68, 0x1C, 0x07, 0xA7, 0x9F, 0x82,
	0xC0, 0x35, 0x3A, 0x61, 0xF3, 0x34, 0x62, 0x2F, 0x47, 0x73, 0x0E, 0xD7,
	0xDD, 0x9D, 0xE5, 0x5C, 0x97, 0x8D, 0x78, 0x5E, 0xD7, 0xAA, 0x8F, 0x48,
	0xB8, 0x09, 0x33, 0x83, 0x88, 0x57, 0xFE, 0x17, 0x3A, 0xDC, 0x1C, 0x75,
	0x92, 0xC0, 0xC1, 0xB2, 0x78, 0x85, 0x54, 0xF7, 0xD7, 0xA3, 0xCD, 0xA8,
	0x12, 0x35, 0x38, 0x16, 0x00, 0x58, 0xEE, 0xD6, 0x54, 0x59, 0x19, 0x5D,
	0x9E, 0x55, 0x26, 0x74, 0x29, 0x1D, 0xF5, 0x8C, 0x72, 0xD4, 0x1F, 0xC5,
	0x09, 0x00, 0x29, 0x04, 0x29, 0x71, 0x69, 0xC6, 0x59, 0x3A, 0x54, 0x4B,
	0x2F, 0xA0, 0xBD, 0x18, 0x47, 0xB1, 0x02, 0x70, 0x5A, 0xB8, 0x45, 0xBE,
	0x28, 0xE0, 0xA5, 0x08, 0xCB, 0x40, 0x93, 0x65, 0x7A, 0xC4, 0xA6, 0x8F,
	0xC3, 0x53, 0xFC, 0xC1
};
#endif

#if ITE_DEBUG
static const uint8_t private_key_2048[] = {
	0x01, 0x29, 0x2E, 0x33, 0x7B, 0x8C, 0xD5, 0x0E, 0xF6, 0x6F, 0xD6, 0x34, 0x9A, 0x4F, 0xE8,
	0x9A, 0x65, 0x64, 0x2E, 0xA2, 0xFA, 0xE1, 0x71, 0xED, 0xCE, 0x5C, 0x9E, 0x2A, 0x30, 0xAA,
	0x81, 0x4B, 0x3D, 0x60, 0x63, 0xFC, 0x8E, 0xBA, 0x46, 0xE1, 0x8E, 0x28, 0x58, 0x22, 0xDF,
	0x9F, 0x48, 0xCA, 0x7B, 0x4C, 0xBF, 0xF6, 0x08, 0x2A, 0x37, 0xF3, 0xED, 0x09, 0x8A, 0x07,
	0x3E, 0x41, 0x30, 0x14, 0x21, 0xDD, 0x88, 0xEE, 0x25, 0xA8, 0xF5, 0xDB, 0x43, 0x2D, 0x1C,
	0x02, 0xEB, 0xE3, 0xC2, 0x53, 0x62, 0x65, 0xBE, 0x8C, 0x6B, 0xC9, 0x2D, 0xBB, 0xAE, 0xDA,
	0xDA, 0x4D, 0x7A, 0xD5, 0x09, 0xF5, 0xB8, 0xC8, 0x54, 0xDE, 0x7E, 0x4A, 0xFC, 0xCE, 0xD2,
	0xA0, 0x56, 0x85, 0x77, 0x62, 0x2F, 0x4B, 0x5A, 0xCD, 0x3B, 0xB5, 0xA4, 0x81, 0x48, 0x80,
	0x39, 0x6A, 0x4E, 0x87, 0x50, 0x0A, 0xD8, 0x0B, 0x5D, 0xAA, 0xBC, 0x59, 0x29, 0x98, 0xDF,
	0x8E, 0x38, 0xD0, 0x3F, 0xA0, 0x29, 0xCF, 0xBF, 0x65, 0x49, 0x5A, 0x7C, 0x8F, 0xA0, 0x31,
	0x88, 0x3E, 0xAB, 0xF0, 0xF4, 0x24, 0x1D, 0x45, 0xC1, 0x61, 0xC5, 0xF2, 0xA8, 0xD1, 0xC1,
	0x11, 0xB2, 0x7A, 0x29, 0xFA, 0xE5, 0xA8, 0x20, 0x0E, 0x88, 0xAD, 0x0D, 0x65, 0xA1, 0x0C,
	0xE7, 0xD7, 0x19, 0xB0, 0x1F, 0xA5, 0xB3, 0x55, 0x65, 0x7A, 0xDA, 0xA5, 0x74, 0xA1, 0xD9,
	0x84, 0x55, 0xB1, 0xE8, 0xAB, 0xE0, 0x44, 0xE4, 0x73, 0x23, 0x3A, 0x5C, 0x8B, 0xA2, 0x29,
	0x09, 0x09, 0x3B, 0x9D, 0xF0, 0xDB, 0x9E, 0xFC, 0x1E, 0x9E, 0x3D, 0xC3, 0x56, 0x59, 0xA2,
	0x68, 0x47, 0xFC, 0xE6, 0x22, 0x28, 0xCA, 0x38, 0x51, 0x03, 0x14, 0xED, 0x0A, 0xCE, 0x6D,
	0x60, 0xF5, 0xF7, 0x54, 0xAD, 0x0E, 0x5A, 0xF5, 0x93, 0xC8, 0x4E, 0x47, 0xA3, 0x67, 0xD1,
	0xCE};
#else
static const uint8_t private_key_2048[256] = {
	0x13, 0x51, 0x8F, 0x08, 0x29, 0x15, 0x16, 0xC2, 0x58, 0x35, 0xD2, 0x5A,
	0xD7, 0x8A, 0xBE, 0x88, 0x31, 0xA7, 0xB3, 0x7C, 0x7A, 0x43, 0xB2, 0x40,
	0xE3, 0xF4, 0x71, 0x15, 0x3E, 0x54, 0xD9, 0x14, 0x56, 0x3E, 0x07, 0x03,
	0xC6, 0xF9, 0x7F, 0xFB, 0x63, 0xFB, 0xF7, 0x91, 0x28, 0xE0, 0x3A, 0x96,
	0xEB, 0x44, 0x6E, 0x32, 0xEC, 0x2B, 0x82, 0xB7, 0xAE, 0x29, 0x6C, 0xEB,
	0x6D, 0x35, 0x02, 0x33, 0xC9, 0xD0, 0xBE, 0xD4, 0x53, 0xE7, 0xE9, 0x0E,
	0xC3, 0x23, 0x69, 0x50, 0x56, 0x8E, 0x88, 0x08, 0x42, 0x79, 0xD9, 0xD0,
	0x11, 0xBC, 0x1A, 0x71, 0x9E, 0xC5, 0x40, 0xB1, 0x62, 0x88, 0xF9, 0x7B,
	0xA8, 0x3A, 0xFD, 0xB0, 0x24, 0x14, 0x42, 0x9B, 0x16, 0x74, 0xB5, 0xDE,
	0x8F, 0x1F, 0xD4, 0x6C, 0x64, 0x56, 0xF4, 0x31, 0xD6, 0x1F, 0x78, 0x9F,
	0x92, 0x76, 0x1A, 0x00, 0x0C, 0xA1, 0xFD, 0x6E, 0x4A, 0x7F, 0xA7, 0x27,
	0x4E, 0x5F, 0x3A, 0x6B, 0x6A, 0x6E, 0x4D, 0xD9, 0x2C, 0xEF, 0x2F, 0x17,
	0xF4, 0xF8, 0x5F, 0x04, 0xB6, 0xED, 0xEA, 0x18, 0x64, 0x55, 0x91, 0x17,
	0x3A, 0xD1, 0xE7, 0x07, 0xCD, 0x9C, 0x3B, 0x53, 0xEE, 0xA2, 0x55, 0x74,
	0x5F, 0x4B, 0xA2, 0x9E, 0xF1, 0x38, 0x92, 0x3F, 0x10, 0x18, 0x76, 0x97,
	0xE3, 0xEA, 0xF0, 0xB4, 0x15, 0xD1, 0xE8, 0x96, 0x31, 0x33, 0x75, 0x81,
	0x8A, 0xD5, 0xE9, 0xC0, 0x5F, 0x88, 0x60, 0x18, 0x6D, 0xEC, 0xE9, 0x87,
	0xD0, 0xFC, 0xED, 0x12, 0xE0, 0x29, 0xDA, 0x9D, 0xA7, 0xB9, 0x9B, 0x15,
	0xD7, 0x04, 0xD5, 0xCD, 0xFE, 0x0E, 0x38, 0xA1, 0x06, 0xF8, 0xA6, 0x86,
	0xEB, 0x63, 0x99, 0x7D, 0x5E, 0x42, 0x3C, 0x5B, 0x2C, 0xDC, 0x5D, 0x38,
	0x7F, 0xAF, 0xE5, 0x15, 0x3A, 0x89, 0x0F, 0xCF, 0x40, 0x26, 0xD5, 0x84,
	0xA5, 0xE4, 0x33, 0xF1
};
#endif

/* messages with pkcs#1 v1.5 padding */
#if ITE_DEBUG
static char plaintext_2048[] = {
	0x00, 0x01, 0xff, 0xff, 0xff, 0xff, 0xff, 0xff, 0xff, 0xff, 0xff, 0xff, 0xff, 0xff, 0xff,
	0xff, 0xff, 0xff, 0xff, 0xff, 0xff, 0xff, 0xff, 0xff, 0xff, 0xff, 0xff, 0xff, 0xff, 0xff,
	0xff, 0xff, 0xff, 0xff, 0xff, 0xff, 0xff, 0xff, 0xff, 0xff, 0xff, 0xff, 0xff, 0xff, 0xff,
	0xff, 0xff, 0xff, 0xff, 0xff, 0xff, 0xff, 0xff, 0xff, 0xff, 0xff, 0xff, 0xff, 0xff, 0xff,
	0xff, 0xff, 0xff, 0xff, 0xff, 0xff, 0xff, 0xff, 0xff, 0xff, 0xff, 0xff, 0xff, 0xff, 0xff,
	0xff, 0xff, 0xff, 0xff, 0xff, 0xff, 0xff, 0xff, 0xff, 0xff, 0xff, 0xff, 0xff, 0xff, 0xff,
	0xff, 0xff, 0xff, 0xff, 0xff, 0xff, 0xff, 0xff, 0xff, 0xff, 0xff, 0xff, 0xff, 0xff, 0xff,
	0xff, 0xff, 0xff, 0xff, 0xff, 0xff, 0xff, 0xff, 0xff, 0xff, 0xff, 0xff, 0xff, 0xff, 0xff,
	0xff, 0xff, 0xff, 0xff, 0xff, 0xff, 0xff, 0xff, 0xff, 0xff, 0xff, 0xff, 0xff, 0xff, 0xff,
	0xff, 0xff, 0xff, 0xff, 0xff, 0xff, 0xff, 0xff, 0xff, 0xff, 0xff, 0xff, 0xff, 0xff, 0xff,
	0xff, 0xff, 0xff, 0xff, 0xff, 0xff, 0xff, 0xff, 0xff, 0xff, 0xff, 0xff, 0xff, 0xff, 0xff,
	0xff, 0xff, 0xff, 0xff, 0xff, 0xff, 0xff, 0xff, 0xff, 0xff, 0xff, 0xff, 0xff, 0xff, 0xff,
	0xff, 0xff, 0xff, 0xff, 0xff, 0xff, 0xff, 0xff, 0xff, 0xff, 0xff, 0xff, 0xff, 0xff, 0xff,
	0xff, 0xff, 0xff, 0xff, 0xff, 0xff, 0xff, 0xff, 0xff, 0x00, 0x30, 0x31, 0x30, 0x0d, 0x06,
	0x09, 0x60, 0x86, 0x48, 0x01, 0x65, 0x03, 0x04, 0x02, 0x01, 0x05, 0x00, 0x04, 0x20, 0x55,
	0x00, 0x6e, 0xb2, 0x39, 0xfe, 0x5e, 0x9f, 0x48, 0xfa, 0x4f, 0x42, 0x10, 0x7f, 0x65, 0x5d,
	0xe6, 0x7b, 0x9d, 0xd7, 0xff, 0x2c, 0x66, 0x6b, 0xbe, 0xdd, 0x1d, 0x0c, 0x61, 0x8c, 0xa4,
	0x69};
#else
static char plaintext_2048[256] = {
	0x00, 0x01, 0xFF, 0xFF, 0xFF, 0xFF, 0xFF, 0xFF, 0xFF, 0xFF, 0xFF, 0xFF, 0xFF, 0xFF, 0xFF, 0xFF,
	0xFF, 0xFF, 0xFF, 0xFF, 0xFF, 0xFF, 0xFF, 0xFF, 0xFF, 0xFF, 0xFF, 0xFF, 0xFF, 0xFF, 0xFF, 0xFF,
	0xFF, 0xFF, 0xFF, 0xFF, 0xFF, 0xFF, 0xFF, 0xFF, 0xFF, 0xFF, 0xFF, 0xFF, 0xFF, 0xFF, 0xFF, 0xFF,
	0xFF, 0xFF, 0xFF, 0xFF, 0xFF, 0xFF, 0xFF, 0xFF, 0xFF, 0xFF, 0xFF, 0xFF, 0xFF, 0xFF, 0xFF, 0xFF,
	0xFF, 0xFF, 0xFF, 0xFF, 0xFF, 0xFF, 0xFF, 0xFF, 0xFF, 0xFF, 0xFF, 0xFF, 0xFF, 0xFF, 0xFF, 0xFF,
	0xFF, 0xFF, 0xFF, 0xFF, 0xFF, 0xFF, 0xFF, 0xFF, 0xFF, 0xFF, 0xFF, 0xFF, 0xFF, 0xFF, 0xFF, 0xFF,
	0xFF, 0xFF, 0xFF, 0xFF, 0xFF, 0xFF, 0xFF, 0xFF, 0xFF, 0xFF, 0xFF, 0xFF, 0xFF, 0xFF, 0xFF, 0xFF,
	0xFF, 0xFF, 0xFF, 0xFF, 0xFF, 0xFF, 0xFF, 0xFF, 0xFF, 0xFF, 0xFF, 0xFF, 0xFF, 0xFF, 0xFF, 0xFF,
	0xFF, 0xFF, 0xFF, 0xFF, 0xFF, 0xFF, 0xFF, 0xFF, 0xFF, 0xFF, 0xFF, 0xFF, 0xFF, 0xFF, 0xFF, 0xFF,
	0xFF, 0xFF, 0xFF, 0xFF, 0xFF, 0xFF, 0xFF, 0xFF, 0xFF, 0xFF, 0xFF, 0xFF, 0xFF, 0xFF, 0xFF, 0xFF,
	0xFF, 0xFF, 0xFF, 0xFF, 0xFF, 0xFF, 0xFF, 0xFF, 0xFF, 0xFF, 0xFF, 0xFF, 0xFF, 0xFF, 0xFF, 0xFF,
	0xFF, 0xFF, 0xFF, 0xFF, 0xFF, 0xFF, 0xFF, 0xFF, 0xFF, 0xFF, 0xFF, 0xFF, 0xFF, 0xFF, 0xFF, 0xFF,
	0xFF, 0xFF, 0xFF, 0xFF, 0xFF, 0xFF, 0xFF, 0xFF, 0xFF, 0xFF, 0xFF, 0xFF, 0x00, 0x30, 0x31, 0x30,
	0x0D, 0x06, 0x09, 0x60, 0x86, 0x48, 0x01, 0x65, 0x03, 0x04, 0x02, 0x01, 0x05, 0x00, 0x04, 0x20,
	0x9D, 0xCC, 0xB0, 0xB0, 0xC1, 0x5D, 0x22, 0x2E, 0xE8, 0xEB, 0x31, 0x06, 0xC3, 0x61, 0x01, 0xAB,
	0xCB, 0xA0, 0xA3, 0xED, 0x4F, 0xAF, 0x44, 0x08, 0x83, 0xBF, 0x91, 0xA0, 0xC6, 0xD0, 0x7C, 0xCB
};
#endif

#if ITE_DEBUG
static char ciphertext_2048[] = {
	0xB2, 0xEB, 0xF3, 0x2C, 0x9A, 0xF8, 0xFE, 0xA7, 0x66, 0xBE, 0x74, 0x41, 0x2B, 0x80, 0xE1,
	0x29, 0x33, 0x6A, 0x1A, 0x38, 0x3C, 0xE6, 0xB9, 0x5E, 0x2A, 0xE8, 0x2A, 0x07, 0xC4, 0xF6,
	0xE3, 0x66, 0x4B, 0x6D, 0x15, 0xEA, 0x6E, 0xBB, 0x9E, 0x9D, 0x55, 0x5E, 0x41, 0x38, 0xC2,
	0x3B, 0x8C, 0xF1, 0xB4, 0xAA, 0xD8, 0x1C, 0x6E, 0x46, 0x47, 0x7D, 0x54, 0x5D, 0xFC, 0xBB,
	0x8D, 0xBD, 0x94, 0x8C, 0x24, 0x39, 0x7B, 0xCA, 0x93, 0x83, 0xB1, 0xA7, 0xFA, 0x48, 0x58,
	0x2F, 0xD8, 0x6B, 0x6E, 0xDA, 0x2A, 0xB3, 0xDE, 0x4A, 0x51, 0x6D, 0xA3, 0x3E, 0xAC, 0x74,
	0x95, 0x3C, 0x04, 0x4B, 0xBB, 0xDB, 0x94, 0xAC, 0xD1, 0x6D, 0xF3, 0x41, 0xB1, 0xC3, 0x36,
	0x38, 0xEC, 0xEF, 0xDB, 0xAE, 0x1B, 0x40, 0x40, 0xED, 0xF3, 0x92, 0xEA, 0x70, 0xCC, 0x84,
	0x49, 0x4E, 0xD7, 0x2A, 0x65, 0x7B, 0x50, 0x00, 0xFF, 0x81, 0x90, 0xFD, 0x80, 0xAF, 0x80,
	0x40, 0xD6, 0xB5, 0x16, 0x16, 0x67, 0x78, 0xE6, 0x6B, 0x96, 0x36, 0x0B, 0x26, 0xF2, 0x68,
	0x7D, 0x41, 0x29, 0x0D, 0x92, 0xBD, 0x8F, 0x6A, 0x91, 0xE1, 0x82, 0x5A, 0x85, 0xBE, 0x75,
	0x88, 0x1E, 0x15, 0xC5, 0x8C, 0x81, 0x17, 0x39, 0x4F, 0xB3, 0x31, 0x6A, 0x7A, 0xA7, 0x26,
	0x79, 0x82, 0xFD, 0x7F, 0xB5, 0xFA, 0xB7, 0xF0, 0x44, 0x89, 0x79, 0xCF, 0x6C, 0x67, 0x4E,
	0xF4, 0x26, 0xB1, 0x4A, 0xCD, 0x16, 0xBA, 0xC6, 0x6D, 0xF0, 0x6A, 0xCE, 0x94, 0x8D, 0x5D,
	0x55, 0xBC, 0x75, 0x69, 0xB2, 0x86, 0xAB, 0x10, 0x2E, 0xC7, 0x77, 0x03, 0x86, 0x61, 0x84,
	0xC7, 0xDB, 0x8A, 0x62, 0x8F, 0x3E, 0x0C, 0x28, 0x4F, 0x64, 0xF5, 0x29, 0x66, 0x06, 0xFD,
	0x94, 0x9D, 0x87, 0x6E, 0xFE, 0xF0, 0xFE, 0x28, 0x49, 0x68, 0x57, 0x59, 0x97, 0xE1, 0x30,
	0xB2};
#else
static char ciphertext_2048[256] = {
	0x0D, 0x82, 0xFC, 0x48, 0xDF, 0xCE, 0x73, 0x7F, 0x68, 0x17, 0x0A, 0x8B, 0x70, 0x4E, 0x72, 0x1F,
	0x37, 0x00, 0x3B, 0x2F, 0x0D, 0xE4, 0xFE, 0x90, 0xD6, 0x81, 0xC8, 0xFA, 0x08, 0x72, 0x75, 0x18,
	0xF4, 0xC9, 0xCA, 0xB2, 0x2E, 0xC1, 0xC0, 0xD3, 0xE6, 0xE3, 0xE3, 0x13, 0x62, 0xBB, 0x17, 0x3E,
	0x06, 0xB8, 0x73, 0xA7, 0xDC, 0x2D, 0x50, 0x17, 0xC2, 0xC7, 0xDC, 0x23, 0xC5, 0x4F, 0x2E, 0x7D,
	0x6F, 0xBD, 0xC3, 0x09, 0xE6, 0x45, 0x16, 0x94, 0x0D, 0x4F, 0x55, 0x83, 0x05, 0xF4, 0xE7, 0xCA,
	0xC6, 0xCD, 0xD0, 0x9B, 0x71, 0xF1, 0x2D, 0xB4, 0x0E, 0x85, 0xA4, 0x4C, 0x6A, 0x5C, 0x2E, 0x47,
	0xFD, 0x30, 0x7E, 0x00, 0x1C, 0x1C, 0x1C, 0xD2, 0x49, 0x83, 0x04, 0x76, 0x40, 0x57, 0x22, 0x7B,
	0x90, 0xE0, 0x9F, 0xFA, 0x51, 0x6A, 0x22, 0xEF, 0x87, 0x59, 0x97, 0xAF, 0x69, 0x79, 0x99, 0x2E,
	0xA7, 0x11, 0xF0, 0xC7, 0x3F, 0xA4, 0xEC, 0x64, 0x0D, 0xBE, 0x88, 0x29, 0x5E, 0x14, 0x90, 0x6B,
	0xEF, 0x30, 0xB0, 0xF9, 0x6A, 0x1C, 0xBE, 0x90, 0xB2, 0x99, 0x63, 0xB9, 0xC3, 0x0B, 0x38, 0x90,
	0xE0, 0xC8, 0x0B, 0xD2, 0xC3, 0x7C, 0xB9, 0x7E, 0x7C, 0x17, 0x23, 0x73, 0x75, 0xD2, 0x71, 0xDE,
	0xDB, 0x82, 0xF7, 0x92, 0x7C, 0x3A, 0x6F, 0xFB, 0x34, 0xF3, 0x94, 0xDB, 0xAC, 0x77, 0xDA, 0xD0,
	0xF7, 0x0C, 0x21, 0x50, 0x5F, 0x48, 0x04, 0x5B, 0xD0, 0x1C, 0xB1, 0x31, 0x13, 0xBF, 0xD5, 0xD7,
	0x25, 0x20, 0xB4, 0xEC, 0x84, 0xD3, 0x2C, 0x10, 0x7A, 0xB2, 0x64, 0x68, 0x85, 0x58, 0xB5, 0xA5,
	0x43, 0xC0, 0xA2, 0x2C, 0x8F, 0x58, 0x7F, 0x03, 0x37, 0x04, 0x75, 0x6C, 0x0D, 0x41, 0xE4, 0x00,
	0x1D, 0x1B, 0x2C, 0x36, 0xEE, 0xF2, 0xCE, 0x5A, 0x01, 0xB3, 0xDA, 0x60, 0xCB, 0x93, 0x2D, 0xAC
};
#endif

#endif /* ZEPHYR_TESTS_IT51XXX_EVB_RSA_2048_KEYS_H */
```

## src/rsa_4096_keys.h
```c
/*
 * Copyright (c) 2026 ITE Technology Inc.
 *
 * SPDX-License-Identifier: Apache-2.0
 */

#ifndef ZEPHYR_TESTS_IT51XXX_EVB_RSA_4096_KEYS_H
#define ZEPHYR_TESTS_IT51XXX_EVB_RSA_4096_KEYS_H

static const uint8_t public_key_4096[] = {
	0x79, 0x2C, 0x4F, 0x57, 0x6F, 0xFF, 0x62, 0xAF, 0x45, 0xC1, 0xE4, 0x67, 0x2C, 0x78, 0x6B,
	0xE0, 0x3E, 0xEB, 0x03, 0xFB, 0x11, 0xD4, 0x05, 0x3A, 0x23, 0xE9, 0x8A, 0x33, 0x53, 0x93,
	0xCD, 0x32, 0xC5, 0x67, 0x1C, 0x58, 0xA6, 0xE3, 0xF3, 0x86, 0x84, 0x9C, 0x33, 0xEE, 0x77,
	0xAF, 0x6C, 0xC1, 0x35, 0xDE, 0x8E, 0x8C, 0xDB, 0xF0, 0x35, 0x0D, 0xFC, 0x51, 0x20, 0xC6,
	0x48, 0x00, 0xB7, 0x4D, 0xCE, 0xE7, 0x6A, 0x94, 0xA2, 0xAB, 0xEA, 0xF8, 0x7B, 0xEC, 0x46,
	0x7E, 0xEE, 0xCF, 0x98, 0x37, 0xAE, 0x14, 0x31, 0xD6, 0xFF, 0x4B, 0x14, 0xE0, 0xD5, 0x55,
	0xC5, 0x6A, 0x7B, 0x92, 0xDF, 0x1E, 0x26, 0xF3, 0x43, 0xE9, 0x69, 0x9A, 0x8C, 0x2D, 0xAB,
	0xAD, 0x2E, 0x86, 0x36, 0xBD, 0xB0, 0x7E, 0xDD, 0xB3, 0x7F, 0xE8, 0x54, 0xF6, 0x6C, 0x10,
	0x8B, 0xB1, 0x95, 0x79, 0x5C, 0xB6, 0xE8, 0x15, 0xFA, 0x8A, 0xFA, 0xF3, 0xE1, 0x8B, 0x7B,
	0x24, 0xE1, 0xA9, 0x4F, 0xF1, 0x12, 0xB4, 0x4E, 0x28, 0xB4, 0x79, 0x8C, 0xF3, 0xC8, 0x27,
	0xC5, 0x03, 0x71, 0xCA, 0xDB, 0x73, 0x1C, 0x64, 0x60, 0xB0, 0xE5, 0xE6, 0x7F, 0x8E, 0x02,
	0x6B, 0x22, 0x34, 0xAF, 0x73, 0xFF, 0x3F, 0xAD, 0x94, 0xD0, 0x7C, 0xA2, 0x58, 0xF2, 0xF1,
	0x0B, 0xB7, 0x66, 0xEB, 0x4D, 0x8D, 0x15, 0xBD, 0x7D, 0x12, 0x05, 0x31, 0x67, 0xF5, 0x65,
	0x67, 0x5A, 0x42, 0x8B, 0xEE, 0xA4, 0x4A, 0x5B, 0x9A, 0x92, 0x9E, 0x31, 0x39, 0x37, 0x22,
	0x08, 0xBC, 0x0E, 0xF7, 0xD8, 0xD7, 0x34, 0x0A, 0xA2, 0xB4, 0x33, 0xED, 0x23, 0xF7, 0xD5,
	0xA9, 0x8E, 0xAC, 0xBC, 0x81, 0xBE, 0x11, 0x6C, 0x93, 0xB2, 0x73, 0x8C, 0x05, 0x40, 0x77,
	0x6C, 0xB0, 0xE3, 0xCB, 0xA2, 0xE7, 0xF5, 0x66, 0x2B, 0x07, 0x42, 0xB7, 0xEF, 0x01, 0x0F,
	0xD0, 0xF9, 0x50, 0x81, 0x5E, 0xAC, 0xDB, 0x0C, 0x9D, 0x04, 0xD9, 0x66, 0xE5, 0x6F, 0x27,
	0x2E, 0x44, 0x1E, 0xD5, 0xE4, 0x3E, 0xD5, 0x07, 0x35, 0x8E, 0xC5, 0xBA, 0xB0, 0x58, 0x85,
	0xD0, 0x39, 0x90, 0x10, 0xF7, 0x18, 0x8A, 0x64, 0x39, 0x08, 0xD8, 0x3C, 0xD3, 0xB9, 0xB2,
	0xEA, 0x21, 0x60, 0x28, 0xF8, 0x9D, 0xC5, 0xE0, 0xA9, 0x39, 0xAA, 0x3B, 0x35, 0x19, 0x5B,
	0xA2, 0x0F, 0x9E, 0x15, 0xFD, 0x0B, 0xD8, 0x0A, 0xE9, 0x51, 0x80, 0xF6, 0x7F, 0xAF, 0x8D,
	0x24, 0x4A, 0xD1, 0x3E, 0x0F, 0xB5, 0xBD, 0xA5, 0xF5, 0x3D, 0xFC, 0x15, 0x5E, 0xE4, 0xC7,
	0x79, 0x32, 0xB1, 0x6B, 0xFE, 0x84, 0x96, 0x22, 0x78, 0x58, 0x6F, 0x10, 0xFD, 0x1C, 0x5E,
	0xEB, 0xF0, 0x76, 0xCD, 0x2B, 0x9F, 0xD9, 0x30, 0x02, 0xF5, 0x58, 0xA7, 0x3A, 0xDD, 0x76,
	0xCC, 0x8D, 0xB7, 0xC7, 0x05, 0xD0, 0x66, 0x4A, 0x42, 0x86, 0x02, 0xC4, 0xCA, 0xD1, 0x7A,
	0xD7, 0x48, 0x77, 0xE9, 0xA9, 0x8B, 0x1C, 0xBE, 0xAC, 0xD8, 0xA4, 0xB5, 0xB0, 0xD4, 0x9B,
	0xFF, 0xC1, 0xEB, 0x87, 0x2B, 0x67, 0x54, 0x22, 0xB4, 0xB2, 0x10, 0x1C, 0xD8, 0xA9, 0xFA,
	0x1D, 0x29, 0xEA, 0x5D, 0xD7, 0x76, 0x74, 0x08, 0x27, 0x47, 0xB5, 0x20, 0x4D, 0x75, 0x81,
	0x93, 0x74, 0x1E, 0x65, 0xA3, 0x79, 0x34, 0xA9, 0x8F, 0x1A, 0x3C, 0xB1, 0x56, 0x93, 0xEE,
	0xBE, 0x07, 0xA5, 0x91, 0x10, 0x49, 0xA8, 0x04, 0x73, 0xFA, 0x1B, 0x98, 0xFC, 0x33, 0x14,
	0xD2, 0x39, 0x5E, 0x88, 0x8E, 0x98, 0xC3, 0xAD, 0x1C, 0xC7, 0xCC, 0xA0, 0xD8, 0x58, 0x2F,
	0x3A, 0xE0, 0x07, 0x94, 0xDE, 0xE7, 0xF8, 0x5B, 0x3F, 0xC7, 0xF8, 0x85, 0xB5, 0xC5, 0x86,
	0xA6, 0x7E, 0xD1, 0x7E, 0xBD, 0xA4, 0x3E, 0x45, 0x36, 0xD6, 0xF8, 0x5A, 0xB4, 0xF4, 0x80,
	0xB1, 0xAA};

static const uint8_t private_key_4096[] = {
	0x01, 0xA2, 0x94, 0x35, 0x12, 0x05, 0x9D, 0x2B, 0xD4, 0x6F, 0x07, 0x50, 0x2F, 0x21, 0x10,
	0x36, 0x20, 0xB6, 0x51, 0x52, 0xEC, 0xA0, 0x60, 0x54, 0x1D, 0xEA, 0xB0, 0x52, 0x9C, 0xE6,
	0x89, 0x5B, 0xFA, 0x6E, 0x7E, 0xF1, 0x49, 0x91, 0x08, 0x8B, 0x65, 0x30, 0xE7, 0x53, 0x62,
	0x97, 0x63, 0xCC, 0xC0, 0x93, 0x16, 0x73, 0x39, 0x57, 0xA4, 0xF0, 0xD3, 0xD9, 0xAB, 0x30,
	0x8F, 0xCD, 0x15, 0x50, 0xBD, 0xB0, 0x21, 0xFA, 0x51, 0x93, 0x9A, 0x41, 0xB4, 0x4B, 0x3B,
	0xF8, 0x3C, 0x4C, 0x7E, 0x34, 0x17, 0x8A, 0xD0, 0x5D, 0x8D, 0x35, 0x63, 0x30, 0x60, 0x06,
	0xD6, 0xE3, 0xB2, 0x3B, 0xA1, 0x77, 0x49, 0x14, 0x84, 0x22, 0xC1, 0x9D, 0x95, 0x93, 0x40,
	0x9A, 0xF1, 0x2E, 0xD1, 0x0F, 0xCE, 0x9A, 0x33, 0xF0, 0x92, 0x52, 0x24, 0x62, 0x18, 0xE2,
	0x7F, 0xD6, 0xD4, 0x1A, 0x45, 0x87, 0xE8, 0x7D, 0x18, 0xF3, 0x5E, 0x3A, 0x16, 0x82, 0xCE,
	0x2B, 0x7C, 0xD7, 0xB0, 0x6F, 0xE0, 0x37, 0xEA, 0x78, 0xCF, 0x36, 0x08, 0xB0, 0x98, 0x73,
	0xC9, 0x67, 0xD5, 0xC9, 0x93, 0x15, 0x26, 0x94, 0x28, 0x85, 0x4F, 0xDC, 0xF2, 0x5C, 0x11,
	0x59, 0xC0, 0x0B, 0x35, 0x56, 0xB5, 0x90, 0xAC, 0xEB, 0x58, 0xF1, 0x12, 0xE5, 0x43, 0xD2,
	0x23, 0x64, 0x3B, 0x31, 0xBF, 0xFB, 0x68, 0x78, 0x4C, 0x26, 0x53, 0x34, 0x98, 0x0E, 0xB5,
	0x44, 0xD0, 0xD3, 0x16, 0xE5, 0x32, 0xB6, 0xA2, 0xFB, 0x48, 0xED, 0x3E, 0x20, 0x50, 0x0A,
	0x15, 0x5A, 0x2C, 0xA4, 0x8D, 0x7E, 0x47, 0x48, 0xA5, 0xCA, 0x1D, 0x32, 0x84, 0x90, 0xAE,
	0x05, 0x1B, 0x9B, 0x12, 0x81, 0x87, 0x01, 0xA3, 0x45, 0xB5, 0xDF, 0x9A, 0x8B, 0x76, 0x30,
	0xFD, 0x13, 0xCA, 0x6B, 0xF8, 0xA3, 0x55, 0x08, 0x5D, 0x36, 0x76, 0x78, 0x9F, 0x3D, 0xA8,
	0xAD, 0x55, 0xD7, 0x37, 0x91, 0xE1, 0x18, 0x05, 0x82, 0x26, 0x78, 0x1E, 0x83, 0x33, 0x38,
	0xB1, 0x3B, 0x15, 0xA9, 0x38, 0x2A, 0x27, 0xCC, 0x08, 0x61, 0xAA, 0x18, 0xDA, 0xA6, 0x98,
	0xE7, 0x20, 0xA1, 0xC1, 0x2A, 0xB5, 0x15, 0x4D, 0xB7, 0x1B, 0x3F, 0xCD, 0xFB, 0x20, 0x59,
	0x9D, 0x2E, 0xB0, 0x2B, 0x4B, 0xDD, 0x66, 0x17, 0xA9, 0x7B, 0xDA, 0x7A, 0x56, 0x93, 0x03,
	0xD7, 0x4C, 0x9D, 0xCF, 0x20, 0x4D, 0x81, 0xC1, 0x1C, 0xAA, 0x3D, 0x1D, 0x8B, 0xAF, 0x5E,
	0x6A, 0x86, 0x7B, 0xA0, 0xA7, 0xD9, 0x59, 0x2E, 0x6B, 0x7D, 0x9C, 0x6B, 0x29, 0x0E, 0x03,
	0x57, 0xE5, 0x4D, 0xC9, 0x41, 0x99, 0x58, 0x30, 0x11, 0x71, 0xB4, 0xD9, 0xBC, 0xBE, 0x24,
	0x10, 0x71, 0xB0, 0xDE, 0x09, 0xB4, 0x88, 0x81, 0x61, 0xAD, 0xAB, 0xDF, 0x65, 0x8E, 0x9D,
	0x1A, 0x27, 0xC6, 0x21, 0xF3, 0xCE, 0x53, 0x7E, 0x6D, 0xA1, 0x64, 0x75, 0x45, 0x86, 0x22,
	0xAE, 0xEF, 0x17, 0xCF, 0xD3, 0x63, 0x70, 0x8B, 0x17, 0x6F, 0x4A, 0x70, 0xF3, 0xD4, 0x1B,
	0xB6, 0x73, 0x6D, 0x80, 0x6F, 0x63, 0x32, 0x0E, 0x22, 0xC0, 0x0D, 0xF1, 0xB6, 0x46, 0xF6,
	0xDE, 0xA5, 0xCC, 0xAC, 0x93, 0xBC, 0xC2, 0xE3, 0x0F, 0x41, 0x3A, 0xF3, 0xCF, 0x7D, 0xDD,
	0xB0, 0x31, 0x90, 0xA8, 0xEA, 0x89, 0x29, 0x0E, 0x31, 0xC0, 0xA0, 0x2A, 0x1C, 0x09, 0x2C,
	0x1D, 0xE3, 0x28, 0xD9, 0x5A, 0x8F, 0xC2, 0x98, 0x48, 0xBF, 0x88, 0x7B, 0x81, 0x19, 0xE9,
	0x79, 0x81, 0x33, 0x40, 0xF6, 0xD1, 0x18, 0xC3, 0x4D, 0xC9, 0xF8, 0xD8, 0xB4, 0x9B, 0xBB,
	0x33, 0x57, 0xA2, 0x7F, 0x14, 0xDB, 0xE3, 0xC6, 0xCF, 0x29, 0xAE, 0x55, 0x7D, 0xD0, 0xF5,
	0x73, 0xB6, 0xBF, 0x07, 0x2F, 0x4A, 0x32, 0x19, 0xDD, 0x10, 0x45, 0xEB, 0x32, 0xB8, 0x67,
	0xC1, 0x4B};

/* messages with pkcs#1 v1.5 padding */
static const char plaintext_4096[] = {
	0x00, 0x01, 0xff, 0xff, 0xff, 0xff, 0xff, 0xff, 0xff, 0xff, 0xff, 0xff, 0xff, 0xff, 0xff,
	0xff, 0xff, 0xff, 0xff, 0xff, 0xff, 0xff, 0xff, 0xff, 0xff, 0xff, 0xff, 0xff, 0xff, 0xff,
	0xff, 0xff, 0xff, 0xff, 0xff, 0xff, 0xff, 0xff, 0xff, 0xff, 0xff, 0xff, 0xff, 0xff, 0xff,
	0xff, 0xff, 0xff, 0xff, 0xff, 0xff, 0xff, 0xff, 0xff, 0xff, 0xff, 0xff, 0xff, 0xff, 0xff,
	0xff, 0xff, 0xff, 0xff, 0xff, 0xff, 0xff, 0xff, 0xff, 0xff, 0xff, 0xff, 0xff, 0xff, 0xff,
	0xff, 0xff, 0xff, 0xff, 0xff, 0xff, 0xff, 0xff, 0xff, 0xff, 0xff, 0xff, 0xff, 0xff, 0xff,
	0xff, 0xff, 0xff, 0xff, 0xff, 0xff, 0xff, 0xff, 0xff, 0xff, 0xff, 0xff, 0xff, 0xff, 0xff,
	0xff, 0xff, 0xff, 0xff, 0xff, 0xff, 0xff, 0xff, 0xff, 0xff, 0xff, 0xff, 0xff, 0xff, 0xff,
	0xff, 0xff, 0xff, 0xff, 0xff, 0xff, 0xff, 0xff, 0xff, 0xff, 0xff, 0xff, 0xff, 0xff, 0xff,
	0xff, 0xff, 0xff, 0xff, 0xff, 0xff, 0xff, 0xff, 0xff, 0xff, 0xff, 0xff, 0xff, 0xff, 0xff,
	0xff, 0xff, 0xff, 0xff, 0xff, 0xff, 0xff, 0xff, 0xff, 0xff, 0xff, 0xff, 0xff, 0xff, 0xff,
	0xff, 0xff, 0xff, 0xff, 0xff, 0xff, 0xff, 0xff, 0xff, 0xff, 0xff, 0xff, 0xff, 0xff, 0xff,
	0xff, 0xff, 0xff, 0xff, 0xff, 0xff, 0xff, 0xff, 0xff, 0xff, 0xff, 0xff, 0xff, 0xff, 0xff,
	0xff, 0xff, 0xff, 0xff, 0xff, 0xff, 0xff, 0xff, 0xff, 0xff, 0xff, 0xff, 0xff, 0xff, 0xff,
	0xff, 0xff, 0xff, 0xff, 0xff, 0xff, 0xff, 0xff, 0xff, 0xff, 0xff, 0xff, 0xff, 0xff, 0xff,
	0xff, 0xff, 0xff, 0xff, 0xff, 0xff, 0xff, 0xff, 0xff, 0xff, 0xff, 0xff, 0xff, 0xff, 0xff,
	0xff, 0xff, 0xff, 0xff, 0xff, 0xff, 0xff, 0xff, 0xff, 0xff, 0xff, 0xff, 0xff, 0xff, 0xff,
	0xff, 0xff, 0xff, 0xff, 0xff, 0xff, 0xff, 0xff, 0xff, 0xff, 0xff, 0xff, 0xff, 0xff, 0xff,
	0xff, 0xff, 0xff, 0xff, 0xff, 0xff, 0xff, 0xff, 0xff, 0xff, 0xff, 0xff, 0xff, 0xff, 0xff,
	0xff, 0xff, 0xff, 0xff, 0xff, 0xff, 0xff, 0xff, 0xff, 0xff, 0xff, 0xff, 0xff, 0xff, 0xff,
	0xff, 0xff, 0xff, 0xff, 0xff, 0xff, 0xff, 0xff, 0xff, 0xff, 0xff, 0xff, 0xff, 0xff, 0xff,
	0xff, 0xff, 0xff, 0xff, 0xff, 0xff, 0xff, 0xff, 0xff, 0xff, 0xff, 0xff, 0xff, 0xff, 0xff,
	0xff, 0xff, 0xff, 0xff, 0xff, 0xff, 0xff, 0xff, 0xff, 0xff, 0xff, 0xff, 0xff, 0xff, 0xff,
	0xff, 0xff, 0xff, 0xff, 0xff, 0xff, 0xff, 0xff, 0xff, 0xff, 0xff, 0xff, 0xff, 0xff, 0xff,
	0xff, 0xff, 0xff, 0xff, 0xff, 0xff, 0xff, 0xff, 0xff, 0xff, 0xff, 0xff, 0xff, 0xff, 0xff,
	0xff, 0xff, 0xff, 0xff, 0xff, 0xff, 0xff, 0xff, 0xff, 0xff, 0xff, 0xff, 0xff, 0xff, 0xff,
	0xff, 0xff, 0xff, 0xff, 0xff, 0xff, 0xff, 0xff, 0xff, 0xff, 0xff, 0xff, 0xff, 0xff, 0xff,
	0xff, 0xff, 0xff, 0xff, 0xff, 0xff, 0xff, 0xff, 0xff, 0xff, 0xff, 0xff, 0xff, 0xff, 0xff,
	0xff, 0xff, 0xff, 0xff, 0xff, 0xff, 0xff, 0xff, 0xff, 0xff, 0xff, 0xff, 0xff, 0xff, 0xff,
	0xff, 0xff, 0xff, 0xff, 0xff, 0xff, 0xff, 0xff, 0xff, 0xff, 0xff, 0xff, 0xff, 0xff, 0xff,
	0xff, 0xff, 0xff, 0xff, 0xff, 0xff, 0xff, 0xff, 0xff, 0xff, 0x00, 0x30, 0x31, 0x30, 0x0d,
	0x06, 0x09, 0x60, 0x86, 0x48, 0x01, 0x65, 0x03, 0x04, 0x02, 0x01, 0x05, 0x00, 0x04, 0x20,
	0x55, 0x00, 0x6e, 0xb2, 0x39, 0xfe, 0x5e, 0x9f, 0x48, 0xfa, 0x4f, 0x42, 0x10, 0x7f, 0x65,
	0x5d, 0xe6, 0x7b, 0x9d, 0xd7, 0xff, 0x2c, 0x66, 0x6b, 0xbe, 0xdd, 0x1d, 0x0c, 0x61, 0x8c,
	0xa4, 0x69};

static const char ciphertext_4096[] = {
	0xF4, 0x02, 0xAD, 0x31, 0xA5, 0x74, 0x7F, 0x98, 0xE1, 0xEA, 0x47, 0x9F, 0xA4, 0x21, 0x84,
	0x74, 0xCD, 0x73, 0x02, 0x2D, 0x98, 0xBF, 0x9B, 0x50, 0x39, 0xE7, 0xAB, 0xD2, 0x83, 0x24,
	0x64, 0x25, 0x75, 0x36, 0x24, 0xE7, 0x0C, 0x83, 0xBF, 0x0D, 0xCF, 0x9E, 0xF9, 0xB8, 0x2B,
	0x0F, 0xCC, 0x44, 0x39, 0xE5, 0xE5, 0x38, 0xE4, 0x59, 0xC4, 0x78, 0x10, 0xAB, 0x8A, 0x23,
	0x65, 0xBB, 0x43, 0x41, 0x85, 0xE2, 0x30, 0x52, 0x37, 0x6B, 0x8B, 0xA1, 0x75, 0x43, 0x5F,
	0x6F, 0xC5, 0x24, 0xEC, 0x53, 0x52, 0x23, 0xD8, 0x5D, 0x45, 0xF6, 0x7F, 0xBC, 0x17, 0x3B,
	0x35, 0x66, 0x35, 0xA7, 0x06, 0xF0, 0x9A, 0x0A, 0xC8, 0xC2, 0x95, 0x26, 0xC4, 0x64, 0x64,
	0x55, 0xA0, 0xC5, 0xF3, 0x56, 0xC0, 0x7B, 0x1A, 0x91, 0xB3, 0xC1, 0x18, 0xB5, 0xAC, 0xEA,
	0x3E, 0x0C, 0xCA, 0xC0, 0xAA, 0x16, 0x2F, 0xBB, 0x2B, 0x51, 0xC9, 0xDF, 0x80, 0xB2, 0xE5,
	0x64, 0x57, 0x2B, 0x68, 0x5E, 0xFD, 0x1F, 0x6B, 0x2D, 0xAC, 0x0B, 0x70, 0x4D, 0x06, 0xD6,
	0x15, 0x70, 0xF2, 0xE8, 0x58, 0xF3, 0xAB, 0xC9, 0x42, 0x50, 0xCD, 0x85, 0xF6, 0x15, 0x36,
	0x50, 0x0F, 0xA4, 0xF5, 0x22, 0xBD, 0xA7, 0x15, 0x27, 0x74, 0xBF, 0xBA, 0xC2, 0x18, 0xDA,
	0x36, 0x4B, 0x52, 0x83, 0x8E, 0x4A, 0xFB, 0x6A, 0x0B, 0xF2, 0xE5, 0x42, 0xFE, 0x28, 0x4D,
	0xAF, 0x3F, 0xEC, 0xD9, 0x44, 0xDE, 0xA9, 0x2D, 0xBE, 0xB6, 0xEE, 0x68, 0xF6, 0x2E, 0xA0,
	0x59, 0xC6, 0xC3, 0x78, 0x62, 0x1C, 0x8B, 0x61, 0x02, 0xCF, 0x46, 0xEE, 0xB7, 0xCF, 0xBD,
	0xDC, 0x63, 0xCA, 0x23, 0x55, 0x3C, 0x1E, 0x1B, 0xBD, 0x9D, 0x23, 0xCC, 0xC3, 0xFE, 0xD6,
	0xE5, 0x59, 0x08, 0x0F, 0x28, 0xCC, 0xC5, 0x8D, 0xDE, 0xB2, 0x02, 0x35, 0x5C, 0x9D, 0x36,
	0x6D, 0xFD, 0x1F, 0xCC, 0x5E, 0x26, 0xEA, 0x25, 0x31, 0x0E, 0xC4, 0xB4, 0x50, 0x6F, 0xED,
	0x68, 0x68, 0x84, 0xE6, 0xAE, 0x4E, 0x8E, 0x84, 0x7B, 0x78, 0x18, 0x01, 0x7F, 0x92, 0xA8,
	0x35, 0xFA, 0x31, 0x71, 0x8C, 0xA5, 0x5D, 0xCC, 0x48, 0x65, 0xF1, 0xCB, 0x37, 0x88, 0xFE,
	0x5C, 0x8D, 0x4B, 0xAD, 0x52, 0xFB, 0x49, 0x3A, 0x95, 0x35, 0x13, 0xB2, 0xB7, 0xFA, 0xD1,
	0x2E, 0xEB, 0xC0, 0xE1, 0x2B, 0x5D, 0x07, 0x55, 0xD3, 0x52, 0x0F, 0x20, 0xCD, 0x02, 0x63,
	0x51, 0x01, 0x42, 0xFC, 0xC3, 0xFE, 0x1D, 0xED, 0xC3, 0xF1, 0x51, 0xE9, 0xB1, 0x91, 0x1A,
	0xE0, 0x11, 0xD9, 0xE4, 0x95, 0xF5, 0x68, 0xEE, 0x6F, 0xDF, 0xDE, 0x9C, 0xFE, 0xC0, 0x27,
	0x1D, 0x3D, 0xC6, 0x58, 0xBE, 0x66, 0xE8, 0x2E, 0x48, 0x3C, 0xAF, 0xB8, 0xBA, 0x19, 0x57,
	0x9F, 0x88, 0x3C, 0x72, 0x68, 0x31, 0x8E, 0xAA, 0x48, 0x86, 0x1C, 0x08, 0x2E, 0xB8, 0x10,
	0x9D, 0x15, 0xF5, 0x7D, 0xEA, 0x8E, 0xB7, 0x05, 0xF3, 0xC6, 0x01, 0x80, 0x2F, 0x19, 0x70,
	0xB2, 0xE8, 0x1D, 0xEA, 0xBC, 0x9F, 0x2F, 0x9C, 0x11, 0xE4, 0x2E, 0x4D, 0xFA, 0x4F, 0x55,
	0xAE, 0xF8, 0x86, 0x5C, 0x36, 0xCB, 0x7D, 0xA1, 0xF0, 0x5B, 0x1A, 0x12, 0xA5, 0x3D, 0x30,
	0x7A, 0x31, 0x0B, 0x1D, 0xAB, 0xF5, 0xB2, 0xEB, 0x25, 0x68, 0xE7, 0xFD, 0x01, 0x40, 0x75,
	0x6A, 0x8E, 0xC2, 0x0E, 0x8D, 0xC5, 0xBC, 0xBD, 0x77, 0x7D, 0x42, 0xB1, 0x0D, 0xBA, 0xD4,
	0x2E, 0x3D, 0x9F, 0x09, 0xA3, 0xB8, 0x17, 0xB3, 0x60, 0x52, 0x41, 0x6C, 0xAC, 0x42, 0x07,
	0x82, 0x37, 0x6F, 0x9E, 0xA7, 0x40, 0x6D, 0x2A, 0x60, 0x94, 0x38, 0x45, 0x24, 0x93, 0x28,
	0x38, 0x0D, 0x65, 0xA8, 0xBA, 0xE7, 0xF1, 0xD7, 0x84, 0xB8, 0xF4, 0x52, 0x9D, 0x71, 0x91,
	0x68, 0x7D};

#endif /* ZEPHYR_TESTS_IT51XXX_EVB_RSA_4096_KEYS_H */
```

## src/test_hw_rsa.c
```c
/*
 * Copyright (c) 2026 ITE Technology Inc.
 *
 * SPDX-License-Identifier: Apache-2.0
 */

#include <zephyr/drivers/misc/it51xxx_hw_rsa/it51xxx_hw_rsa.h>
#include <zephyr/kernel.h>
#include <zephyr/ztest.h>

#include "rsa_2048_keys.h"
#include "rsa_4096_keys.h"

ZTEST(it51xxx_hw_rsa, test_2048_key_bits)
{
	const bool exponent_3 = false;
	struct device *rsa_device = (struct device *)DEVICE_DT_GET(DT_NODELABEL(hw_rsa));
	static struct it51xxx_rsa_messages msgs;
	static uint8_t output[sizeof(ciphertext_2048)];
	struct it51xxx_rsa_keys keys = {
		.private_key = private_key_2048,
		.private_key_sz = sizeof(private_key_2048),
		.public_key = public_key_2048,
		.public_key_sz = sizeof(public_key_2048),
	};
	int ret;

	ret = it51xxx_hw_rsa_configure(rsa_device, keys);
	zassert_equal(ret, 0, "failed to configure keys");
	msgs.plain = plaintext_2048;
	msgs.plain_size = sizeof(plaintext_2048);
	msgs.cipher = output;
	msgs.cipher_size = sizeof(output);
	memset(output, 0, sizeof(output));
	ret = it51xxx_hw_rsa_encrypt(rsa_device, &msgs);
	zassert_equal(ret, 0, "failed to perform encryption");
	ret = memcmp(msgs.cipher, ciphertext_2048, sizeof(ciphertext_2048));
	zassert_equal(ret, 0, "encrypt error");

	ret = it51xxx_hw_rsa_configure(rsa_device, keys);
	zassert_equal(ret, 0, "failed to configure keys");
	msgs.cipher = ciphertext_2048;
	msgs.cipher_size = sizeof(ciphertext_2048);
	msgs.plain = output;
	msgs.plain_size = sizeof(output);
	memset(output, 0, sizeof(output));
	ret = it51xxx_hw_rsa_decrypt(rsa_device, exponent_3, &msgs);
	zassert_equal(ret, 0, "failed to perform decryption");

	ret = memcmp(msgs.plain, plaintext_2048, sizeof(plaintext_2048));
	zassert_equal(ret, 0, "decrypt error");
}

#if 0
ZTEST(it51xxx_hw_rsa, test_4096_key_bits)
{
	const bool exponent_3 = false;
	struct device *rsa_device = (struct device *)DEVICE_DT_GET(DT_NODELABEL(hw_rsa));
	static struct it51xxx_rsa_messages msgs;
	static uint8_t output[sizeof(ciphertext_4096)];
	struct it51xxx_rsa_keys keys = {
		.private_key = private_key_4096,
		.private_key_sz = sizeof(private_key_4096),
		.public_key = public_key_4096,
		.public_key_sz = sizeof(public_key_4096),
	};
	int ret;

	ret = it51xxx_hw_rsa_configure(rsa_device, keys);
	zassert_equal(ret, 0, "failed to configure keys");
	msgs.plain = plaintext_4096;
	msgs.plain_size = sizeof(plaintext_4096);
	msgs.cipher = output;
	msgs.cipher_size = sizeof(output);
	memset(output, 0, sizeof(output));
	ret = it51xxx_hw_rsa_encrypt(rsa_device, &msgs);
	zassert_equal(ret, 0, "failed to perform encryption");
	ret = memcmp(msgs.cipher, ciphertext_4096, sizeof(ciphertext_4096));
	zassert_equal(ret, 0, "encrypt error");

	ret = it51xxx_hw_rsa_configure(rsa_device, keys);
	zassert_equal(ret, 0, "failed to configure keys");
	msgs.cipher = ciphertext_4096;
	msgs.cipher_size = sizeof(ciphertext_4096);
	msgs.plain = output;
	msgs.plain_size = sizeof(output);
	memset(output, 0, sizeof(output));
	ret = it51xxx_hw_rsa_decrypt(rsa_device, exponent_3, &msgs);
	zassert_equal(ret, 0, "failed to perform encryption");
	ret = memcmp(msgs.plain, plaintext_4096, sizeof(plaintext_4096));
	zassert_equal(ret, 0, "decrypt error");
}
#endif

ZTEST_SUITE(it51xxx_hw_rsa, NULL, NULL, NULL, NULL, NULL);
```
