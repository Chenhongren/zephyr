## boards/microchip/mec15xxevb_assy6853/Kconfig.defconfig
```kconfig
# Copyright (c) 2019 Intel Corporation
# SPDX-License-Identifier: Apache-2.0

if BOARD_MEC15XXEVB_ASSY6853

config INPUT
	default y if KSCAN

config ESPI_XEC
	default y
	depends on ESPI

endif # BOARD_MEC15XXEVB_ASSY6853
```

## drivers/clock_control/Kconfig.it8xxx2
```kconfig
# Copyright (c) 2024 ITE Corporation.
# SPDX-License-Identifier: Apache-2.0

config CLOCK_CONTROL_IT8XXX2
	bool "it8xxx2 clock control"
	default y
	depends on DT_HAS_ITE_IT8XXX2_ECPM_ENABLED
	help
	  Enable support for the it8xxx2 clock control.
```

## drivers/misc/ite_i3c/Kconfig
```kconfig
# Copyright (c) 2025 ITE Corporation.
# SPDX-License-Identifier: Apache-2.0

config ITE_I3C_SAMPLE
	bool
	depends on DT_HAS_ITE_IT51XXX_I3CM_ENABLED || DT_HAS_ITE_IT51XXX_I3CS_ENABLED
	default y
	help
	  Enable the ite i3c sample driver, including tgt mqueue and ctrl dummy device.

if ITE_I3C_SAMPLE

config I3C_TGT_MQUEUE
	bool "I3C target message queue driver"
	depends on DT_HAS_ITE_I3C_TGT_MQUEUE_ENABLED
	default y if I3CS_IT51XXX

config I3C_CTRL_DUMMY
	bool "I3C controller dummy driver"
	depends on DT_HAS_ITE_I3C_CTRL_DUMMY_ENABLED
	default y if I3CM_IT51XXX

endif # ITE_I3C_SAMPLE
```

## drivers/spi/Kconfig.it8xxx2
```kconfig
# ITE IT8XXX2
#
# Copyright (c) 2024 ITE Technology Inc.
#
# SPDX-License-Identifier: Apache-2.0
#

config SPI_ITE_IT8XXX2
	bool "ITE IT8XXX2 SPI Driver"
	default y
	depends on SOC_IT8XXX2
	select SOC_IT8XXX2_CPU_IDLE_GATING
	select PINCTRL
	help
	  Enable driver for the ITE IT8XXX2 SSPI Driver.
```

## drivers/usb/udc/Kconfig.it82xx2
```kconfig
# Copyright (c) 2023 Linaro Limited
# SPDX-License-Identifier: Apache-2.0

config UDC_IT82XX2
	bool "IT82XX2 USB device controller driver"
	default y
	depends on DT_HAS_ITE_IT82XX2_USB_ENABLED
	help
	  IT82xx2 USB device controller driver.

config UDC_IT82XX2_EVENT_COUNT
	int "Number or blocks in event slab"
	depends on UDC_IT82XX2
	range 4 16
	default 16
	help
	  Number of blocks in slab for internal endpoint events.
```

## dts/bindings/clock/ite,it8xxx2-clock.yaml
```yaml
# Copyright (c) 2024 ITE Corporation.
# SPDX-License-Identifier: Apache-2.0

description: it8xxx2 ECPM node

compatible: "ite,it8xxx2-ecpm"

include: [clock-controller.yaml, base.yaml]

properties:
  reg:
    required: true

clock-cells:
- bus
- ctrl
- bit
```

## dts/bindings/gpio/ite,it51xxx-gpio.yaml
```yaml
# Copyright (c) 2025 ITE Corporation. All Rights Reserved.
# SPDX-License-Identifier: Apache-2.0

description: This binding gives a base representation of the it51xxx series gpio

compatible: "ite,it51xxx-gpio"

include: [gpio-controller.yaml, base.yaml]

properties:
  reg:
    required: true

  has-volt-sel:
    type: array
    description: |
      Selection of support input voltage 3.3V or 1.8V.

  wucctrl:
    type: phandles
    description: |

gpio-cells:
  - pin
  - flags
```

## dts/bindings/gpio/ite,it8xxx2-gpiogcr.yaml
```yaml
# Copyright (c) 2024 ITE Corporation. All Rights Reserved.
# SPDX-License-Identifier: Apache-2.0

description: IT8XXX2 GPIO General Control

compatible: "ite,it8xxx2-gpiogcr"

include: [base.yaml]

properties:
  reg:
    required: true

  "#spi-io-mode-cells":
    type: int
    const: 2

spi-io-mode-cells:
- offset
- bit
```

## dts/bindings/interrupt-controller/ite,it51xxx-intc.yaml
```yaml
# Copyright (c) 2025 ITE Corporation. All Rights Reserved.
# SPDX-License-Identifier: Apache-2.0

description: ITE Interrupt controller
compatible: "ite,it51xxx-intc"

include: [interrupt-controller.yaml, base.yaml]

properties:
  reg:
    required: true

  isr-reg:
    type: array

  ier-reg:
    type: array

  ielmr-reg:
    type: array

  ipolr-reg:
    type: array

interrupt-cells:
  - irq
  - flags
```

## dts/bindings/misc/ite,i3c-ctrl-dummy.yaml
```yaml
# Copyright (c) 2025 ITE Corporation. All Rights Reserved.
# SPDX-License-Identifier: Apache-2.0

description: I3C controller dummy driver

compatible: "ite,i3c-ctrl-dummy"

include:
  - name: i3c-device.yaml
    property-blocklist:
      - label

properties:
  label:
    type: string
```

## dts/bindings/misc/ite,i3c-tgt-mqueue.yaml
```yaml
# Copyright (c) 2025 ITE Corporation. All Rights Reserved.
# SPDX-License-Identifier: Apache-2.0

description: I3C target message queue driver

compatible: "ite,i3c-tgt-mqueue"

include: [base.yaml]
      
properties:
  label:
    type: string
```

## dts/bindings/ps2/ite,it51xxx-ps2.yaml
```yaml
# Copyright (c) 2026 ITE Corporation. All Rights Reserved.
# SPDX-License-Identifier: Apache-2.0

description: IT51XXX PS2 controller

compatible: "ite,it51xxx-ps2"

include: [ps2.yaml, pinctrl-device.yaml]

properties:
  reg:
    required: true

  interrupts:
    required: true

  wucctrl:
    type: phandles
    description: |
      ps2 wuc interrupt.
```

## dts/bindings/spi/ite,it8xxx2-spi.yaml
```yaml
# Copyright (c) 2024 ITE Corporation. All Rights Reserved.
# SPDX-License-Identifier: Apache-2.0

description: IT8XXX2 SPI

compatible: "ite,it8xxx2-spi"

include: [spi-controller.yaml, pinctrl-device.yaml]

properties:
  reg:
    required: true

  interrupts:
    required: true

  pinctrl-names:
    required: true

  pinctrl-0:
    type: phandles
    required: true

  max-frequency:
    type: int

  quad-mode:
    type: boolean
    description: |
      Enable quad mode

  spi-io-modes:
    type: phandle-array
    description: |
      SPI IO modes(dual/quad mode) entries, e.g. <&phandles OFFSET BIT>.
      The bits must be configured to enable SPI dual/quad GPIO pin
      before starting communication.

  spi-io-mode-names:
    type: string-array
    description: |
      Names of each spi-io-modes entry.

  clocks:
    required: true
```

## dts/bindings/usb/zephyr,hid-device.yaml
```yaml
# Copyright (c) 2023 Nordic Semiconductor ASA
# SPDX-License-Identifier: Apache-2.0

description: Bindings for virtual HID device

compatible: "zephyr,hid-device"

include: base.yaml

properties:
  interface-name:
    type: string
    description: |
      HID device name. When this property is present, a USB device will use it
      as the string descriptor of the interface.

  boot-protocol-code:
    type: string
    required: true
    description: |
      Device can be used as a Boot Device and supports a predefined protocol
      for mouse or keyboards.
      - none:     Device does not support the boot interface
      - keyboard: Device supports boot interface and keyboard protocol
      - mouse:    Device supports boot interface and mouse protocol
    enum:
      - none
      - keyboard
      - mouse

  polling-rate:
    type: int
    required: true
    description: |
      Input type reports polling rate in number of 125µs periods.
      Depending on the actual speed, the calculated polling rate could be clamped
      to 1ms or 255ms.

  in-report-size:
    type: int
    required: true
    description: |
      The size of the longest input report that the HID device can generate.
      This property is used to determine the buffer length used for transfers.

  out-report-size:
    type: int
    description: |
      The size of the longest output report that the HID device can generate.
      When this property is present, a USB device will use out pipe for output
      reports, otherwise control pipe will be used for output reports.
```

## subsys/usb/device_next/class/Kconfig.hid
```kconfig
# Copyright (c) 2023 Nordic Semiconductor ASA
# SPDX-License-Identifier: Apache-2.0

menuconfig USBD_HID_SUPPORT
	bool "USB Human Interface Device support"
	default y
	depends on DT_HAS_ZEPHYR_HID_DEVICE_ENABLED
	help
	  Enables USB Human Interface Device support.

if USBD_HID_SUPPORT

config USBD_HID_BUF_COUNT
	int "Number of buffers in the pool"
	range 1 256
	default 2
	help
	  Number of buffers in the pool per HID instance.

config USBD_HID_INIT_PRIORITY
	int "HID device init priority"
	default KERNEL_INIT_PRIORITY_DEVICE
	help
	  HID device initialization priority

module = USBD_HID
module-str = usbd hid
source "subsys/logging/Kconfig.template.log_config"

endif # USBD_HID_SUPPORT
```
